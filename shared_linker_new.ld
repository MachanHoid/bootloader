/******************************************************************************
 *
 * project.ld - Linker configuration file for project.
 *
 * Copyright (c) 2013-2020 Texas Instruments Incorporated.  All rights reserved.
 * Software License Agreement
 * 
 *   Redistribution and use in source and binary forms, with or without
 *   modification, are permitted provided that the following conditions
 *   are met:
 * 
 *   Redistributions of source code must retain the above copyright
 *   notice, this list of conditions and the following disclaimer.
 * 
 *   Redistributions in binary form must reproduce the above copyright
 *   notice, this list of conditions and the following disclaimer in the
 *   documentation and/or other materials provided with the  
 *   distribution.
 * 
 *   Neither the name of Texas Instruments Incorporated nor the names of
 *   its contributors may be used to endorse or promote products derived
 *   from this software without specific prior written permission.
 * 
 * THIS SOFTWARE IS PROVIDED BY THE COPYRIGHT HOLDERS AND CONTRIBUTORS
 * "AS IS" AND ANY EXPRESS OR IMPLIED WARRANTIES, INCLUDING, BUT NOT
 * LIMITED TO, THE IMPLIED WARRANTIES OF MERCHANTABILITY AND FITNESS FOR
 * A PARTICULAR PURPOSE ARE DISCLAIMED. IN NO EVENT SHALL THE COPYRIGHT
 * OWNER OR CONTRIBUTORS BE LIABLE FOR ANY DIRECT, INDIRECT, INCIDENTAL,
 * SPECIAL, EXEMPLARY, OR CONSEQUENTIAL DAMAGES (INCLUDING, BUT NOT
 * LIMITED TO, PROCUREMENT OF SUBSTITUTE GOODS OR SERVICES; LOSS OF USE,
 * DATA, OR PROFITS; OR BUSINESS INTERRUPTION) HOWEVER CAUSED AND ON ANY
 * THEORY OF LIABILITY, WHETHER IN CONTRACT, STRICT LIABILITY, OR TORT
 * (INCLUDING NEGLIGENCE OR OTHERWISE) ARISING IN ANY WAY OUT OF THE USE
 * OF THIS SOFTWARE, EVEN IF ADVISED OF THE POSSIBILITY OF SUCH DAMAGE.
 * 
 * This is part of revision 2.2.0.295 of the Tiva Firmware Development Package.
 *
 *****************************************************************************/

INCLUDE memory_map.ld

SECTIONS
{
    .text :
    {
        _text = .;
        KEEP(*(.isr_vector))

		*(.text.__shared_start__)
		*(.text.FlashErase)
		*(.text.__shared_size__)
		*(.text.g_ppui32GPIOIntMapSnowflake)
		*(.text.UARTCharPut)
		*(.text.g_ppui32GPIOIntMapBlizzard)
		*(.text.led_off)
		*(.text._ebss)
		*(.text.GPIODirModeSet)
		*(.text.g_pui32VCOFrequencies)
		*(.text._etext)
		*(.text.SysCtlPeripheralDisable)
		*(.text.SysCtlPeripheralEnable)
		*(.text.__bootrom_size__)
		*(.text.__approm_start__)
		*(.text.GPIOPinTypeUART)
		*(.text._edata)
		*(.text.g_ui32GPIOIntMapSnowflakeRows)
		*(.text._text)
		*(.text.g_ui32GPIOIntMapBlizzardRows)
		*(.text.GPIOPadConfigSet)
		*(.text.g_pui32Xtals)
		*(.text.FlashProgram)
		*(.text.GPIOPinTypeGPIOOutput)
		*(.text.GPIOPinWrite)
		*(.text._data)
		*(.text.SysCtlPeripheralReady)
		*(.text.UARTCharGetNonBlocking)
		*(.text.g_sXTALtoMEMTIM)
		*(.text.g_pppui32XTALtoVCO)
		*(.text.UARTCharGet)
		*(.text.SysCtlClockGet)
		*(.text._bss)
		*(.text.__approm_size__)
		*(.text.led_setup)
		*(.text.UARTEnable)
		*(.text._ldata)
		*(.text.UARTConfigSetExpClk)
		*(.text.UARTDisable)
		*(.text.__bootrom_start__)
		*(.text.GPIOPinConfigure)
		*(.text.led_on)
		*(.text.g_pui32GPIOBaseAddrs)
		*(.text.delay)
        *(.rodata*)
        _etext = .;
    } > SHARED

/DISCARD/ :{
		*(.text.EEPROMBlockHide)
		*(.text.EMACTimestampSysTimeGet)
		*(.text.SHAMD5IntRegister)
		*(.text.LCDIDDCommandWrite)
		*(.text.UARTDMADisable)
		*(.text.g_ppui32SSIIntMap)
		*(.text.AESIVRead)
		*(.text.TimerMatchGet)
		*(.text.USBClockDisable)
		*(.text.DESDataProcess)
		*(.text.OneWireDMADisable)
		*(.text.Crc32)
		*(.text.EMACAddrFilterSet)
		*(.text.ComparatorConfigure)
		*(.text.SysCtlIntEnable)
		*(.text.AESKey1Set)
		*(.text.WatchdogIntTypeSet)
		*(.text.EPIIntErrorClear)
		*(.text.SysCtlPeripheralPowerOff)
		*(.text.SysTickPeriodGet)
		*(.text.HibernateTamperEventsClearNoLock)
		*(.text.WatchdogUnlock)
		*(.text.GPIOPinTypeComparator)
		*(.text.SHAMD5IntEnable)
		*(.text.SSIBusy)
		*(.text.UART9BitEnable)
		*(.text.USBEndpointDataToggleClear)
		*(.text.I2CRxFIFOFlush)
		*(.text.USBLPMRemoteWakeEnabled)
		*(.text.SHAMD5HMACPPKeyGenerate)
		*(.text.EMACFrameFilterSet)
		*(.text.I2CMasterErr)
		*(.text.EEPROMBlockPasswordSet)
		*(.text.TimerLoadSet64)
		*(.text.EMACHashFilterGet)
		*(.text.USBHostPwrFaultEnable)
		*(.text.USBDevAddrGet)
		*(.text.HibernateTamperEnable)
		*(.text.GPIODirModeGet)
		*(.text.OneWireDataGet)
		*(.text.CPUprimask)
		*(.text.GPIOPinTypeOneWire)
		*(.text.USBDevEndpointDataAck)
		*(.text.TimerClockSourceSet)
		*(.text.uDMAControlBaseSet)
		*(.text.PWMClockSet)
		*(.text.TimerIntUnregister)
		*(.text.HibernateClockConfig)
		*(.text.CANIntUnregister)
		*(.text.SHAMD5HashLengthSet)
		*(.text.g_ppui32SSIIntMapSnowflake)
		*(.text.CANRetrySet)
		*(.text.USBHostLPMConfig)
		*(.text.EPIFIFOConfig)
		*(.text.USBULPIDisable)
		*(.text.SSIIntStatus)
		*(.text.Crc16Array3)
		*(.text.UARTSmartCardDisable)
		*(.text.USBDMAChannelAddressSet)
		*(.text.ADCComparatorIntStatus)
		*(.text.ComparatorIntEnable)
		*(.text.SSIDMAEnable)
		*(.text.SSIIntRegister)
		*(.text.EMACTxFlush)
		*(.text.EMACWoLEnter)
		*(.text.WatchdogEnable)
		*(.text.CPUcpsid)
		*(.text.WatchdogReloadSet)
		*(.text.IntDisable)
		*(.text.LCDIntClear)
		*(.text.HibernateIntRegister)
		*(.text.TimerIntRegister)
		*(.text.FlashIntStatus)
		*(.text.TimerControlLevel)
		*(.text.EEPROMStatusGet)
		*(.text.EMACTxDMAPollDemand)
		*(.text.UARTDMAEnable)
		*(.text.CANMessageGet)
		*(.text.EEPROMMassErase)
		*(.text.LCDIntDisable)
		*(.text.USBHostHubAddrSet)
		*(.text.EMACRxDMACurrentDescriptorGet)
		*(.text.TimerControlWaitOnTrigger)
		*(.text.SHAMD5DataWrite)
		*(.text.EMACVLANRxConfigGet)
		*(.text.I2CMasterIntDisable)
		*(.text.ADCReferenceSet)
		*(.text.LCDRasterACBiasIntCountSet)
		*(.text.EPIWorkaroundHWordWrite)
		*(.text.FPUFlushToZeroModeSet)
		*(.text.I2CSlaveFIFODisable)
		*(.text.SSIAdvFrameHoldEnable)
		*(.text.EPIConfigHB16TimingSet)
		*(.text.GPIOPinTypeCAN)
		*(.text.QEIFilterConfigure)
		*(.text.EMACTxDisable)
		*(.text.uDMAChannelAttributeGet)
		*(.text.GPIOIntClear)
		*(.text.EMACHashFilterBitCalculate)
		*(.text.SSIAdvFrameHoldDisable)
		*(.text.HibernateIntEnable)
		*(.text.LCDIDDDataRead)
		*(.text.WatchdogReloadGet)
		*(.text.FPUHalfPrecisionModeSet)
		*(.text.I2CSlaveIntEnableEx)
		*(.text.EMACTxDMACurrentBufferGet)
		*(.text.GPIOADCTriggerEnable)
		*(.text.MPUIntRegister)
		*(.text.ComparatorIntStatus)
		*(.text.GPIOIntDisable)
		*(.text.SysCtlDelay)
		*(.text.ADCIntClearEx)
		*(.text.PWMGenIntRegister)
		*(.text.UART9BitAddrSend)
		*(.text.USBDevEndpointStatusClear)
		*(.text.TimerMatchSet64)
		*(.text.I2CSlaveIntClearEx)
		*(.text.ADCComparatorReset)
		*(.text.HibernateDataSet)
		*(.text.PWMGenFaultTriggerGet)
		*(.text.SSIClockSourceSet)
		*(.text.SSIIntUnregister)
		*(.text.USBDevSpeedGet)
		*(.text.WatchdogIntEnable)
		*(.text.SysExcIntClear)
		*(.text.USBFIFOFlush)
		*(.text._USBIndexWrite)
		*(.text.HibernateTamperIOEnable)
		*(.text.GPIOPinTypeEthernetLED)
		*(.text.DESDataRead)
		*(.text.EMACRxDMAPollDemand)
		*(.text.TimerControlTrigger)
		*(.text.DESConfigSet)
		*(.text.ADCSequenceOverflow)
		*(.text.EMACTimestampPPSCommand)
		*(.text.ADCIntEnableEx)
		*(.text.FlashProtectSave)
		*(.text.HibernateLowBatSet)
		*(.text.LCDRasterConfigSet)
		*(.text._SSIIntNumberGet)
		*(.text.EPINonBlockingReadConfigure)
		*(.text.AESTagRead)
		*(.text.uDMAChannelSizeGet)
		*(.text.I2CMasterControl)
		*(.text.FlashAllUserRegisterSet)
		*(.text.HibernateRTCSSMatchSet)
		*(.text.ADCIntRegister)
		*(.text.UARTRxErrorClear)
		*(.text.FlashProtectGet)
		*(.text.HibernateTamperStatusGet)
		*(.text.AESDataReadNonBlocking)
		*(.text.SysExcIntRegister)
		*(.text.TimerMatchGet64)
		*(.text.EMACVLANTxConfigSet)
		*(.text.SysCtlLDOSleepSet)
		*(.text.TimerUpdateMode)
		*(.text.USBEndpointDataGet)
		*(.text.SysCtlPeripheralDeepSleepDisable)
		*(.text.EMACTimestampSysTimeSet)
		*(.text.I2CMasterSlaveAddrSet)
		*(.text.USBPHYPowerOff)
		*(.text.USBEndpointStatus)
		*(.text.SHAMD5DMAEnable)
		*(.text.g_pui32FMPRERegs)
		*(.text.HibernateTamperDisable)
		*(.text.I2CMasterTimeoutSet)
		*(.text.USBLPMIntEnable)
		*(.text.TimerConfigure)
		*(.text.USBHostAddrGet)
		*(.text.SSIDisable)
		*(.text.EMACRemoteWakeUpFrameFilterSet)
		*(.text.PWMGenIntUnregister)
		*(.text.DESLengthSet)
		*(.text.ADCIntUnregister)
		*(.text.g_ui8SSIIntMapRows)
		*(.text.HibernateCalendarGet)
		*(.text.SysCtlNMIClear)
		*(.text._UARTIntNumberGet)
		*(.text.EMACAddrFilterGet)
		*(.text.HibernateRequest)
		*(.text.USBPHYPowerOn)
		*(.text.AESDataWriteNonBlocking)
		*(.text.EMACPHYExtendedRead)
		*(.text.USBDevEndpointStallClear)
		*(.text.USBHostPwrDisable)
		*(.text.EPIIntEnable)
		*(.text.GPIOPinTypeComparatorOutput)
		*(.text.USBDMAChannelIntEnable)
		*(.text.QEIFilterEnable)
		*(.text.ADCPhaseDelaySet)
		*(.text.USBEndpointPacketCountSet)
		*(.text.USBModeGet)
		*(.text.EMACTimestampTargetIntDisable)
		*(.text.PWMGenEnable)
		*(.text.g_pui8OversampleFactor)
		*(.text.SSIConfigSetExpClk)
		*(.text.SysTickIntRegister)
		*(.text.LCDRasterTimingSet)
		*(.text.FPURoundingModeSet)
		*(.text.SysCtlClockSet)
		*(.text.IntPriorityMaskGet)
		*(.text._USBIndexRead)
		*(.text._CANIntNumberGet)
		*(.text.PWMPulseWidthGet)
		*(.text._SysExcIntNumberGet)
		*(.text.EMACNumAddrGet)
		*(.text.CANStatusGet)
		*(.text.HibernateRTCSSMatchGet)
		*(.text.HibernateTamperEventsClear)
		*(.text.UARTParityModeSet)
		*(.text.SysCtlDeepSleep)
		*(.text.USBDMAChannelIntDisable)
		*(.text.EMACVLANHashFilterGet)
		*(.text.OneWireIntEnable)
		*(.text.PWMSyncTimeBase)
		*(.text.DESDMADisable)
		*(.text.USBDMAChannelEnable)
		*(.text.I2CFIFODataGet)
		*(.text.I2CMasterIntStatus)
		*(.text.UARTSmartCardEnable)
		*(.text.USBDevAddrSet)
		*(.text.HibernateRTCSet)
		*(.text.PWMIntStatus)
		*(.text.WatchdogStallDisable)
		*(.text.HibernateDataGet)
		*(.text.AESDataProcessAuth)
		*(.text.UARTBreakCtl)
		*(.text.EMACPowerManagementStatusGet)
		*(.text._SysCtlFrequencyGet)
		*(.text.PWMDeadBandEnable)
		*(.text.ADCSequenceUnderflow)
		*(.text.HibernateCounterMode)
		*(.text.USBHostSuspend)
		*(.text.PWMGenIntTrigEnable)
		*(.text.SHAMD5HMACKeySet)
		*(.text.TimerRTCDisable)
		*(.text.uDMAControlBaseGet)
		*(.text.UARTModemControlGet)
		*(.text.HibernateRTCMatchGet)
		*(.text.SysCtlPeripheralReset)
		*(.text.SysCtlFlashSizeGet)
		*(.text.SysCtlResetCauseGet)
		*(.text.g_ui8TimerIntMapRows)
		*(.text.USBIntStatusEndpoint)
		*(.text.SSIDataGetNonBlocking)
		*(.text.TimerDisable)
		*(.text.EMACIntStatus)
		*(.text.GPIOIntTypeGet)
		*(.text.ComparatorIntUnregister)
		*(.text.QEIFilterDisable)
		*(.text.SHAMD5DataWriteNonBlocking)
		*(.text.g_ppui32UARTIntMap)
		*(.text.PWMOutputFaultLevel)
		*(.text.SysCtlResetCauseClear)
		*(.text.SSIDataGet)
		*(.text.EMACTimestampSysTimeUpdate)
		*(.text.EPIWorkaroundWordWrite)
		*(.text.USBFIFOConfigSet)
		*(.text.HibernateTamperIODisable)
		*(.text.I2CMasterIntClearEx)
		*(.text.SysCtlDeepSleepClockSet)
		*(.text.I2CFIFODataPutNonBlocking)
		*(.text.OneWireTransaction)
		*(.text.EPIDMATxCount)
		*(.text.g_i8I2CIntMapSnowflakeRows)
		*(.text.EPIPSRAMConfigRegSet)
		*(.text.USBULPIRegRead)
		*(.text.SysCtlPWMClockGet)
		*(.text.SSIAdvDataPutFrameEndNonBlocking)
		*(.text.GPIOPinTypeTimer)
		*(.text.SHAMD5IntDisable)
		*(.text.SysCtlNMIStatus)
		*(.text.g_ui16CANBitValues)
		*(.text.I2CRxFIFOConfigSet)
		*(.text.EEPROMIntClear)
		*(.text.SysCtlResetBehaviorGet)
		*(.text.USBIntRegister)
		*(.text.GPIOIntRegister)
		*(.text.SHAMD5IntClear)
		*(.text.USBDevLPMEnable)
		*(.text.SSIDataPutNonBlocking)
		*(.text.GPIOPinTypeDIVSCLK)
		*(.text.SSIIntClear)
		*(.text.CANMessageClear)
		*(.text.CANRetryGet)
		*(.text.SysTickDisable)
		*(.text.HibernateBatCheckDone)
		*(.text.EMACConfigSet)
		*(.text.AESIntUnregister)
		*(.text.QEIIntRegister)
		*(.text.I2CMasterDisable)
		*(.text.ADCComparatorIntDisable)
		*(.text.EMACTimestampConfigGet)
		*(.text.GPIOUnlockPin)
		*(.text.HibernateTamperUnLock)
		*(.text.I2CIntRegister)
		*(.text.I2CMasterBusy)
		*(.text.EEPROMBlockUnlock)
		*(.text.SysCtlDeepSleepClockConfigSet)
		*(.text.ADCIntStatus)
		*(.text.uDMAIntRegister)
		*(.text.I2CMasterDataPut)
		*(.text.SysCtlVCOGet)
		*(.text.UARTCharPutNonBlocking)
		*(.text.UARTTxIntModeSet)
		*(.text.g_ppui32UARTIntMapSnowflake)
		*(.text.LCDRasterEnabled)
		*(.text.uDMAEnable)
		*(.text.EMACIntDisable)
		*(.text.MPURegionSet)
		*(.text.EPIModeSet)
		*(.text.SHAMD5DataProcess)
		*(.text.EPINonBlockingReadGet32)
		*(.text.SSIIntEnable)
		*(.text.SSILoopbackDisable)
		*(.text.ADCPhaseDelayGet)
		*(.text.CANIntEnable)
		*(.text.EMACTimestampAddendSet)
		*(.text.SysExcIntUnregister)
		*(.text.GPIOPinTypeADC)
		*(.text.SysCtlIntRegister)
		*(.text.USBHostHubAddrGet)
		*(.text.USBNumEndpointsGet)
		*(.text.PWMFaultIntClearExt)
		*(.text.USBEndpointDataSend)
		*(.text.IntMasterEnable)
		*(.text.g_pi16MIIClockDiv)
		*(.text.WatchdogRunning)
		*(.text.GPIOPinTypePWM)
		*(.text.GPIOPinRead)
		*(.text.PWMGenFaultClear)
		*(.text.GPIOIntEnable)
		*(.text.SysCtlPeripheralPowerOn)
		*(.text.ADCSoftwareOversampleConfigure)
		*(.text.QEIPositionGet)
		*(.text.EPIConfigHB8TimingSet)
		*(.text.TimerClockSourceGet)
		*(.text.HibernateIntUnregister)
		*(.text.DESIntStatus)
		*(.text.EEPROMRead)
		*(.text.SHAMD5ResultRead)
		*(.text.SHAMD5IntUnregister)
		*(.text.WatchdogResetDisable)
		*(.text.Crc8CCITT)
		*(.text.PWMFaultIntUnregister)
		*(.text.uDMAChannelSelectDefault)
		*(.text.GPIOPinTypeGPIOInput)
		*(.text.ADCSequenceConfigure)
		*(.text.uDMAIntStatus)
		*(.text.I2CMasterIntDisableEx)
		*(.text._GPIOIntNumberGet)
		*(.text.USBHostEndpointSpeed)
		*(.text.uDMAErrorStatusGet)
		*(.text.g_pui32PendRegs)
		*(.text.TimerIntStatus)
		*(.text.QEIVelocityEnable)
		*(.text.MPURegionEnable)
		*(.text.SHAMD5HMACPPKeySet)
		*(.text.EPIIntStatus)
		*(.text.SysCtlPeripheralPresent)
		*(.text.HibernateGPIORetentionEnable)
		*(.text.UARTTxIntModeGet)
		*(.text.USBHostMode)
		*(.text.EMACInit)
		*(.text.EMACPHYConfigSet)
		*(.text.TimerValueGet)
		*(.text.CANIntClear)
		*(.text.g_pui32UnpendRegs)
		*(.text.I2CMasterIntEnable)
		*(.text.EMACTimestampIntStatus)
		*(.text.LCDRasterDisable)
		*(.text.PWMGenFaultConfigure)
		*(.text.FPUEnable)
		*(.text.EMACPHYPowerOn)
		*(.text.SysCtlPeripheralClockGating)
		*(.text.HibernateDisable)
		*(.text.EPINonBlockingReadStart)
		*(.text.GPIOIntUnregisterPin)
		*(.text.LCDClockReset)
		*(.text.Crc16Array)
		*(.text.I2CLoopbackEnable)
		*(.text.USBDMAChannelConfigSet)
		*(.text.CPUwfi)
		*(.text.USBHostLPMResume)
		*(.text.IntEnable)
		*(.text.USBDevLPMDisable)
		*(.text.USBLPMLinkStateGet)
		*(.text._SysCtlMemTimingGet)
		*(.text.LCDIntEnable)
		*(.text.EMACIntRegister)
		*(.text.WatchdogIntClear)
		*(.text.USBHostEndpointConfig)
		*(.text._HibernateCalendarSet)
		*(.text.EMACPHYWrite)
		*(.text.USBOTGMode)
		*(.text.g_pui32EnRegs)
		*(.text.I2CMasterIntEnableEx)
		*(.text.g_pui32FMPPERegs)
		*(.text.OneWireBusReset)
		*(.text.USBDevConnect)
		*(.text.AESKey3Set)
		*(.text.EMACTxDMADescriptorListGet)
		*(.text.AESDataProcess)
		*(.text.EPIWorkaroundWordRead)
		*(.text.PWMGenConfigure)
		*(.text.QEIVelocityGet)
		*(.text.SysTickEnable)
		*(.text.EMACLPIConfig)
		*(.text.ADCComparatorConfigure)
		*(.text.ADCIntStatusEx)
		*(.text.ADCBusy)
		*(.text.SSIAdvModeSet)
		*(.text.EPIConfigHB16CSSet)
		*(.text.EMACRxDMADescriptorListSet)
		*(.text.EMACRxEnable)
		*(.text.I2CSlaveIntDisable)
		*(.text.USBFIFOAddrGet)
		*(.text.EEPROMIntStatus)
		*(.text.FlashAllUserRegisterSave)
		*(.text.USBFrameNumberGet)
		*(.text.CPUbasepriSet)
		*(.text.USBLPMIntStatus)
		*(.text.OneWireInit)
		*(.text.IntPriorityMaskSet)
		*(.text.USBDevLPMRemoteWake)
		*(.text.TimerPrescaleGet)
		*(.text.FPUStackingDisable)
		*(.text.UARTIntStatus)
		*(.text.DESDMAEnable)
		*(.text.g_ppui32I2CIntMap)
		*(.text.QEIEnable)
		*(.text.I2CSlaveIntDisableEx)
		*(.text.USBOTGSessionRequest)
		*(.text.SSIDMADisable)
		*(.text.LCDIntStatus)
		*(.text.ADCSequenceEnable)
		*(.text.ADCIntDisableEx)
		*(.text.SSIClockSourceGet)
		*(.text.ADCIntClear)
		*(.text.LCDRasterSubPanelEnable)
		*(.text.uDMAIntUnregister)
		*(.text.EMACRxWatchdogTimerSet)
		*(.text.SysCtlReset)
		*(.text.GPIOPinTypeLCD)
		*(.text.TimerADCEventGet)
		*(.text.uDMAErrorStatusClear)
		*(.text.IntPriorityGroupingSet)
		*(.text.SysCtlLDODeepSleepGet)
		*(.text.LCDRasterSubPanelConfigSet)
		*(.text.USBULPIConfig)
		*(.text.EEPROMProgramNonBlocking)
		*(.text.USBHostLPMSend)
		*(.text.LCDIDDConfigSet)
		*(.text._PWMGenIntNumberGet)
		*(.text.UARTModemControlSet)
		*(.text.PWMGenIntStatus)
		*(.text.g_pui16Crc16)
		*(.text.EMACTxDMADescriptorListSet)
		*(.text.FlashIntEnable)
		*(.text.g_pui32Crc32)
		*(.text.I2CSlaveFIFOEnable)
		*(.text.USBEndpointDMADisable)
		*(.text.UART9BitAddrSet)
		*(.text.EMACPHYRead)
		*(.text.EMACRxDMACurrentBufferGet)
		*(.text.SysCtlPeripheralSleepEnable)
		*(.text.g_ppui32I2CIntMapSnowflake)
		*(.text.CRCDataProcess)
		*(.text._EEPROMSectorMaskSet)
		*(.text.USBHostPwrFaultDisable)
		*(.text.EPINonBlockingReadStop)
		*(.text.SHAMD5ConfigSet)
		*(.text.CRCSeedSet)
		*(.text.EMACLPILinkClear)
		*(.text.TimerControlStall)
		*(.text.USBHostRequestINClear)
		*(.text.EPIConfigHB8CSSet)
		*(.text._EPIIntNumberGet)
		*(.text.DESIntUnregister)
		*(.text.ADCSequenceDMADisable)
		*(.text.AESDataRead)
		*(.text.SysExcIntEnable)
		*(.text.EMACRxDisable)
		*(.text._IntDefaultHandler)
		*(.text.EPINonBlockingReadAvail)
		*(.text.HibernateIntStatus)
		*(.text.USBHostEndpointDataAck)
		*(.text.PWMGenIntClear)
		*(.text.UARTFlowControlGet)
		*(.text.FlashIntUnregister)
		*(.text.EEPROMBlockProtectGet)
		*(.text.LCDIDDDMADisable)
		*(.text.EEPROMSizeGet)
		*(.text.TimerLoadGet64)
		*(.text.SysCtlIntUnregister)
		*(.text.CANErrCntrGet)
		*(.text.ComparatorValueGet)
		*(.text.QEIIntClear)
		*(.text.USBIntDisableEndpoint)
		*(.text.EMACFrameFilterGet)
		*(.text.QEIDirectionGet)
		*(.text.I2CSlaveInit)
		*(.text.USBLPMEndpointGet)
		*(.text.GPIOPinTypeEPI)
		*(.text.I2CMasterBurstCountGet)
		*(.text.DESIntRegister)
		*(.text.EPIIntErrorStatus)
		*(.text.PWMPulseWidthSet)
		*(.text.UARTFlowControlSet)
		*(.text.IntTrigger)
		*(.text.USBControllerVersion)
		*(.text.UARTConfigGetExpClk)
		*(.text.uDMAChannelModeGet)
		*(.text.UARTDisableSIR)
		*(.text.EPIIntDisable)
		*(.text.AESDataAuth)
		*(.text.EMACLPIEnter)
		*(.text.HibernateWakeSet)
		*(.text.SysExcIntStatus)
		*(.text.TimerControlEvent)
		*(.text.EPIConfigGPModeSet)
		*(.text.LCDIDDIndexedWrite)
		*(.text.OneWireDMAEnable)
		*(.text.UARTBusy)
		*(.text.USBFIFOConfigGet)
		*(.text.WatchdogResetEnable)
		*(.text.CANEnable)
		*(.text.SHAMD5DMADisable)
		*(.text.SysCtlVoltageEventConfig)
		*(.text.Crc16)
		*(.text.QEIIntEnable)
		*(.text.SHAMD5HMACProcess)
		*(.text.UARTClockSourceSet)
		*(.text.UARTIntDisable)
		*(.text.USBDMAChannelStatusClear)
		*(.text.EEPROMBlockLock)
		*(.text.HibernateTamperEventsConfig)
		*(.text.HibernateRTCTrimGet)
		*(.text.MPUIntUnregister)
		*(.text.g_ppui32TimerIntMapSnowflake)
		*(.text.USBDMAChannelAddressGet)
		*(.text.I2CMasterIntStatusEx)
		*(.text.USBULPIRegWrite)
		*(.text.UARTFIFOLevelSet)
		*(.text.SysCtlSleep)
		*(.text.PWMClockGet)
		*(.text.SysCtlUSBPLLEnable)
		*(.text.SysCtlPeripheralDeepSleepEnable)
		*(.text.SSIIntDisable)
		*(.text.EMACVLANRxConfigSet)
		*(.text.AESIntStatus)
		*(.text.uDMAChannelSelectSecondary)
		*(.text.EMACTimestampPPSSimpleModeSet)
		*(.text.IntPriorityGet)
		*(.text.FlashAllUserRegisterGet)
		*(.text.QEIIntUnregister)
		*(.text.EPINonBlockingReadGet16)
		*(.text.USBHostSpeedGet)
		*(.text.TimerDMAEventSet)
		*(.text.SysCtlMOSCConfigSet)
		*(.text.EMACRxDMADescriptorListGet)
		*(.text.UARTSpaceAvail)
		*(.text.I2CSlaveIntStatusEx)
		*(.text.EMACIntClear)
		*(.text.OneWireDataGetNonBlocking)
		*(.text.ADCSoftwareOversampleStepConfigure)
		*(.text.EPIWorkaroundByteRead)
		*(.text.I2CSlaveIntClear)
		*(.text.LCDRasterFrameBufferSet)
		*(.text.SHAMD5IntStatus)
		*(.text._QEIIntNumberGet)
		*(.text.UARTLoopbackEnable)
		*(.text.I2CSlaveIntStatus)
		*(.text.EMACRemoteWakeUpFrameFilterGet)
		*(.text.IntPendSet)
		*(.text._HibernateWriteComplete)
		*(.text.EMACReset)
		*(.text.uDMAIntClear)
		*(.text.AESDMAEnable)
		*(.text.USBHostEndpointDataToggle)
		*(.text.CRCResultRead)
		*(.text.USBDevEndpointStall)
		*(.text.HibernateTamperExtOscValid)
		*(.text.USBHostReset)
		*(.text.UARTModemControlClear)
		*(.text.EEPROMProgram)
		*(.text.ADCComparatorIntEnable)
		*(.text.EPIIntUnregister)
		*(.text.TimerEnable)
		*(.text.AESConfigSet)
		*(.text.AESKey2Set)
		*(.text.IntMasterDisable)
		*(.text.SysCtlSRAMSizeGet)
		*(.text.EMACAddrGet)
		*(.text.I2CMasterBusBusy)
		*(.text.GPIOPinTypeHibernateRTCCLK)
		*(.text.HibernateRTCDisable)
		*(.text.EMACLPILinkSet)
		*(.text.HibernateTamperExtOscRecover)
		*(.text.UARTIntEnable)
		*(.text.I2CMasterBurstLengthSet)
		*(.text.USBModeConfig)
		*(.text.SysCtlClockFreqSet)
		*(.text.DESDataWrite)
		*(.text.USBDMAChannelStatus)
		*(.text.PWMDeadBandDisable)
		*(.text.PWMOutputInvert)
		*(.text.HibernateRTCMatchSet)
		*(.text.CPUbasepriGet)
		*(.text.EMACAddrSet)
		*(.text.CANBitRateSet)
		*(.text.CANIntRegister)
		*(.text.I2CSlaveIntEnable)
		*(.text.I2CSlaveACKValueSet)
		*(.text.LCDRasterPaletteSet)
		*(.text.USBClockEnable)
		*(.text.I2CMasterIntClear)
		*(.text.HibernateBatCheckStart)
		*(.text.I2CSlaveAddressSet)
		*(.text.SSIEnable)
		*(.text.SysCtlAltClkConfig)
		*(.text.I2CTxFIFOConfigSet)
		*(.text.uDMAChannelAssign)
		*(.text.ADCSequenceDMAEnable)
		*(.text.EMACIntUnregister)
		*(.text.CRCDataWrite)
		*(.text.FlashIntRegister)
		*(.text.USBEndpointDMAChannel)
		*(.text._EEPROMWaitForDone)
		*(.text.MPUDisable)
		*(.text.AESIntDisable)
		*(.text.g_pui8Crc8CCITT)
		*(.text.USBDevLPMConfig)
		*(.text.SysCtlGPIOAHBEnable)
		*(.text.AESIntRegister)
		*(.text.EPIDividerCSSet)
		*(.text.LCDIntUnregister)
		*(.text.USBIntEnableEndpoint)
		*(.text.CANInit)
		*(.text.PWMGenPeriodGet)
		*(.text.HibernateRTCEnable)
		*(.text.ComparatorIntClear)
		*(.text.EPIAddressMapSet)
		*(.text.DESIVSet)
		*(.text.GPIOPinTypeUSBAnalog)
		*(.text.USBEndpointDMAEnable)
		*(.text.ADCProcessorTrigger)
		*(.text.DESDataWriteNonBlocking)
		*(.text.HibernateLowBatGet)
		*(.text.TimerRTCEnable)
		*(.text.g_ppui32TimerIntMap)
		*(.text.CRCConfigSet)
		*(.text.GPIOPinTypeTrace)
		*(.text.OneWireIntClear)
		*(.text.QEIVelocityDisable)
		*(.text.DESIntClear)
		*(.text.IntIsEnabled)
		*(.text.QEIPositionSet)
		*(.text.GPIOPinTypeWakeHigh)
		*(.text.USBHostRequestIN)
		*(.text.SysCtlIntDisable)
		*(.text.FlashUserSave)
		*(.text.EPINonBlockingReadGet8)
		*(.text.PWMSyncUpdate)
		*(.text._I2CIntNumberGet)
		*(.text.TimerIntEnable)
		*(.text.USBHostAddrSet)
		*(.text.TimerIntClear)
		*(.text.uDMAChannelTransferSet)
		*(.text.I2CIntUnregister)
		*(.text.QEIDisable)
		*(.text.USBIntEnableControl)
		*(.text.MPUEnable)
		*(.text.PWMGenIntTrigDisable)
		*(.text.GPIOPinTypeGPIOOutputOD)
		*(.text.EMACVLANHashFilterSet)
		*(.text.ADCHardwareOversampleConfigure)
		*(.text.AESDMADisable)
		*(.text.GPIOPinTypeSSI)
		*(.text.UARTFIFOLevelGet)
		*(.text.USBHostPwrEnable)
		*(.text.AESReset)
		*(.text.DESReset)
		*(.text.USBIntDisableControl)
		*(.text.DESIntEnable)
		*(.text.SysCtlFlashSectorSizeGet)
		*(.text.HibernateIsActive)
		*(.text.GPIOPinWakeStatus)
		*(.text.GPIOIntStatus)
		*(.text.I2CFIFOStatus)
		*(.text.ComparatorIntDisable)
		*(.text.HibernateTamperEventsGet)
		*(.text.SysCtlIntClear)
		*(.text.UARTModemStatusGet)
		*(.text.EMACTimestampDisable)
		*(.text.CANIntDisable)
		*(.text.I2CMasterInitExpClk)
		*(.text.LCDIntRegister)
		*(.text.USBLPMIntDisable)
		*(.text.MPURegionGet)
		*(.text.g_i8I2CIntMapRows)
		*(.text.LCDIDDStatusRead)
		*(.text.SysCtlResetBehaviorSet)
		*(.text.USBDMAChannelDisable)
		*(.text.WatchdogLockState)
		*(.text.I2CSlaveDisable)
		*(.text.EMACTxDMACurrentDescriptorGet)
		*(.text.LCDIDDIndexedRead)
		*(.text.DESKeySet)
		*(.text.EMACDMAStateGet)
		*(.text.EMACTimestampPPSCommandModeSet)
		*(.text.USBDevMode)
		*(.text.ADCIntEnable)
		*(.text.ADCIntDisable)
		*(.text.CANBitTimingGet)
		*(.text.I2CFIFODataPut)
		*(.text.GPIOPinTypeQEI)
		*(.text.TimerSynchronize)
		*(.text.g_pui32Dii16Regs)
		*(.text.HibernateGPIORetentionGet)
		*(.text.ADCSequenceDisable)
		*(.text.I2CTxFIFOFlush)
		*(.text.TimerLoadGet)
		*(.text.USBHostEndpointStatusClear)
		*(.text.g_ui8SSIIntMapSnowflakeRows)
		*(.text.CANBitTimingSet)
		*(.text.TimerDMAEventGet)
		*(.text.g_pfnRAMVectors)
		*(.text.EMACTimestampConfigSet)
		*(.text.GPIOADCTriggerDisable)
		*(.text.GPIODMATriggerDisable)
		*(.text.UARTIntClear)
		*(.text.I2CMasterDataGet)
		*(.text.EEPROMIntDisable)
		*(.text.TimerIntDisable)
		*(.text.TimerLoadSet)
		*(.text._ADCIntNumberGet)
		*(.text.QEIIntStatus)
		*(.text.PWMIntEnable)
		*(.text.SysCtlVoltageEventClear)
		*(.text.GPIOPinTypeI2CSCL)
		*(.text.SysCtlClockOutConfig)
		*(.text.ADCReferenceGet)
		*(.text.uDMAChannelAttributeDisable)
		*(.text.ADCComparatorRegionSet)
		*(.text.EMACTxEnable)
		*(.text.AESAuthLengthSet)
		*(.text.EPIWriteFIFOCountGet)
		*(.text.HibernateWakeGet)
		*(.text.TimerValueGet64)
		*(.text.GPIOPinTypeUSBDigital)
		*(.text.FlashIntDisable)
		*(.text.MPURegionDisable)
		*(.text.SysExcIntDisable)
		*(.text.HibernateEnableExpClk)
		*(.text.FlashUserSet)
		*(.text.HibernateTamperLock)
		*(.text.HibernateCalendarMatchSet)
		*(.text.ADCSequenceUnderflowClear)
		*(.text.uDMAChannelScatterGatherSet)
		*(.text.SysCtlVoltageEventStatus)
		*(.text.uDMAControlAlternateBaseGet)
		*(.text.EMACConfigGet)
		*(.text.UARTFIFOEnable)
		*(.text.EMACPHYExtendedWrite)
		*(.text.I2CMasterGlitchFilterConfigSet)
		*(.text.PWMFaultIntRegister)
		*(.text.DESIntDisable)
		*(.text.PWMIntDisable)
		*(.text.QEIVelocityConfigure)
		*(.text.I2CFIFODataGetNonBlocking)
		*(.text.uDMADisable)
		*(.text.HibernateIntDisable)
		*(.text.USBEndpointDMAConfigSet)
		*(.text._PWMFaultIntNumberGet)
		*(.text.EMACHashFilterSet)
		*(.text.USBDevEndpointConfigGet)
		*(.text.I2CSlaveDataPut)
		*(.text.AESIVSet)
		*(.text.HibernateRTCSSGet)
		*(.text.MPURegionCountGet)
		*(.text.OneWireIntUnregister)
		*(.text.EMACStatusGet)
		*(.text.EMACPowerManagementControlGet)
		*(.text.QEIIntDisable)
		*(.text.EEPROMInit)
		*(.text.PWMGenDisable)
		*(.text.FPUDisable)
		*(.text.EPIPSRAMConfigRegGetNonBlocking)
		*(.text.GPIOIntRegisterPin)
		*(.text.ADCSoftwareOversampleDataGet)
		*(.text.EMACTimestampTargetSet)
		*(.text.EPIPSRAMConfigRegGet)
		*(.text.EPIWorkaroundByteWrite)
		*(.text.FlashIntClear)
		*(.text.SSIDataPut)
		*(.text.uDMAChannelAttributeEnable)
		*(.text.PWMGenPeriodSet)
		*(.text.WatchdogIntRegister)
		*(.text.FPUNaNModeSet)
		*(.text.GPIOPinTypeWakeLow)
		*(.text.EMACPHYPowerOff)
		*(.text.uDMAChannelDisable)
		*(.text.USBDMAChannelCountGet)
		*(.text.uDMAChannelControlSet)
		*(.text._SHAMD5DataWriteMultiple)
		*(.text.g_ui8UARTIntMapRows)
		*(.text.OneWireIntRegister)
		*(.text._HibernateIntNumberGet)
		*(.text.EPIConfigHB8Set)
		*(.text.QEIErrorGet)
		*(.text.SysCtlSleepPowerSet)
		*(.text.IntRegister)
		*(.text.PWMGenFaultStatus)
		*(.text.EMACPHYMMDWrite)
		*(.text.UARTIntUnregister)
		*(.text.I2CSlaveDataGet)
		*(.text.LCDRasterSubPanelDisable)
		*(.text.EMACVLANTxConfigGet)
		*(.text.SysTickIntDisable)
		*(.text.USBULPIEnable)
		*(.text.I2CSlaveStatus)
		*(.text.UARTParityModeGet)
		*(.text.EPIPSRAMConfigRegRead)
		*(.text.TimerPrescaleMatchGet)
		*(.text.EPIWorkaroundHWordRead)
		*(.text.SSIAdvDataPutFrameEnd)
		*(.text.USBEndpointDataAvail)
		*(.text.HibernateRTCGet)
		*(.text.LCDIDDDMAWrite)
		*(.text.ADCClockConfigGet)
		*(.text.EPIIntRegister)
		*(.text.USBDevDisconnect)
		*(.text.EMACLPIStatus)
		*(.text.ComparatorRefSet)
		*(.text.TimerPrescaleMatchSet)
		*(.text.CANIntStatus)
		*(.text.EPIDividerSet)
		*(.text.g_ui8TimerIntMapRowsSnowflake)
		*(.text.TimerADCEventSet)
		*(.text.uDMAChannelRequest)
		*(.text.SysCtlLDODeepSleepSet)
		*(.text.AESDataWrite)
		*(.text.SysCtlDeepSleepPowerSet)
		*(.text._TimerIntNumberGet)
		*(.text.EPINonBlockingReadCount)
		*(.text.ADCSequenceStepConfigure)
		*(.text.PWMGenFaultTriggerSet)
		*(.text.g_ui8UARTIntMapRowsSnowflake)
		*(.text.IntUnregister)
		*(.text.WatchdogStallEnable)
		*(.text.GPIOIntTypeSet)
		*(.text.I2CMasterLineStateGet)
		*(.text.uDMAChannelIsEnabled)
		*(.text.UARTEnableSIR)
		*(.text.IntPriorityGroupingGet)
		*(.text.LCDDMAConfigSet)
		*(.text.EEPROMIntEnable)
		*(.text.SSILoopbackEnable)
		*(.text.ComparatorIntRegister)
		*(.text.USBHostResume)
		*(.text.PWMOutputUpdateMode)
		*(.text.WatchdogIntUnregister)
		*(.text.EEPROMBlockCountGet)
		*(.text.GPIOPinTypeI2C)
		*(.text.LCDModeSet)
		*(.text.UARTIntRegister)
		*(.text.PWMFaultIntClear)
		*(.text.EMACPowerManagementControlSet)
		*(.text.AESIntEnable)
		*(.text.HibernateCalendarMatchGet)
		*(.text.USBDevEndpointConfigSet)
		*(.text.WatchdogValueGet)
		*(.text.USBHostPwrConfig)
		*(.text.g_pui32Priority)
		*(.text.LCDIDDTimingSet)
		*(.text.AESLengthSet)
		*(.text.HibernateIntClear)
		*(.text.I2CSlaveEnable)
		*(.text.SysCtlPeripheralSleepDisable)
		*(.text.USBIntStatusControl)
		*(.text.GPIOPadConfigGet)
		*(.text.SysCtlUSBPLLDisable)
		*(.text.IntPrioritySet)
		*(.text.OneWireIntStatus)
		*(.text.GPIOIntUnregister)
		*(.text.SHAMD5Reset)
		*(.text.TimerPrescaleSet)
		*(.text.UARTFIFODisable)
		*(.text._OneWireIntNumberGet)
		*(.text.EMACTimestampEnable)
		*(.text.FPUStackingEnable)
		*(.text.EPIConfigSDRAMSet)
		*(.text.I2CSlaveACKOverride)
		*(.text.EPIConfigHB16Set)
		*(.text.WatchdogLock)
		*(.text.uDMAChannelEnable)
		*(.text.CANDisable)
		*(.text.USBDMANumChannels)
		*(.text.FlashUserGet)
		*(.text.SysCtlLDOSleepGet)
		*(.text.ADCClockConfigSet)
		*(.text.UARTCharsAvail)
		*(.text.USBDMAChannelIntStatus)
		*(.text.UARTRxErrorGet)
		*(.text.DESDataReadNonBlocking)
		*(.text.HibernateRTCTrimSet)
		*(.text.LCDIDDDataWrite)
		*(.text.g_pui32Regs)
		*(.text.SysTickIntEnable)
		*(.text.ADCSequenceOverflowClear)
		*(.text.SysCtlPIOSCCalibrate)
		*(.text.OneWireBusStatus)
		*(.text.ADCSequenceDataGet)
		*(.text.SysCtlGPIOAHBDisable)
		*(.text.EMACTimestampPPSPeriodSet)
		*(.text.HibernateGPIORetentionDisable)
		*(.text._CANDataRegWrite)
		*(.text.EMACIntEnable)
		*(.text._USBIntNumberGet)
		*(.text.EEPROMBlockProtectSet)
		*(.text.FlashProtectSet)
		*(.text.USBEndpointDataPut)
		*(.text.LCDRasterEnable)
		*(.text.SysTickValueGet)
		*(.text.FPULazyStackingEnable)
		*(.text.I2CMasterEnable)
		*(.text.TimerMatchSet)
		*(.text.SysCtlIntStatus)
		*(.text.CPUcpsie)
		*(.text.PWMOutputState)
		*(.text.HibernateCalendarSet)
		*(.text.SysTickPeriodSet)
		*(.text.USBHostRequestStatus)
		*(.text.UART9BitDisable)
		*(.text.USBIntUnregister)
		*(.text.CANMessageSet)
		*(.text.GPIOPinTypeEthernetMII)
		*(.text.UARTClockSourceGet)
		*(.text.AESIntClear)
		*(.text._CANDataRegRead)
		*(.text.USBDMAChannelCountSet)
		*(.text.WatchdogIntStatus)
		*(.text.ADCComparatorIntClear)
		*(.text.PWMOutputFault)
		*(.text.SysTickIntUnregister)
		*(.text._EEPROMSectorMaskClear)
		*(.text.SysCtlPWMClockSet)
		*(.text.IntPendClear)
		*(.text.EMACTimestampTargetIntEnable)
		*(.text.USBHighSpeed)
		*(.text.EMACVLANHashFilterBitCalculate)
		*(.text.OneWireIntDisable)
		*(.text.USBHostEndpointPing)
		*(.text.QEIConfigure)
		*(.text.EMACPHYMMDRead)
		*(.text.GPIODMATriggerEnable)
	}

    .data : AT(ADDR(.text) + SIZEOF(.text))
    {
        _data = .;
        _ldata = LOADADDR (.data);
        *(vtable)
        *(.data*)
        _edata = .;
    } > SRAM

    .bss :
    {
        _bss = .;
        *(.bss*)
        *(COMMON)
        _ebss = .;
    } > SRAM
}
