INCLUDE linkers/memory_map.ld

SECTIONS
{
    .text :
    {
        _text = .;
        KEEP(*(.isr_vector))

		*(.text.g_pppui32XTALtoVCO)
		*(.text.g_ppui32GPIOIntMapBlizzard)
		*(.text.g_pui32Xtals)
		*(.text.g_ui32GPIOIntMapSnowflakeRows)
		*(.text.__shared_start__)
		*(.text.GPIOPinTypeGPIOOutput)
		*(.text.__bootrom_start__)
		*(.text.g_pui32VCOFrequencies)
		*(.text.SysCtlPeripheralEnable)
		*(.text.g_ui32GPIOIntMapBlizzardRows)
		*(.text._ebss)
		*(.text.UARTCharPut)
		*(.text.GPIOPinTypeUART)
		*(.text.delay)
		*(.text._edata)
		*(.text.g_pui32GPIOBaseAddrs)
		*(.text.led_off)
		*(.text._etext)
		*(.text._data)
		*(.text.GPIOPadConfigSet)
		*(.text.led_on)
		*(.text.FlashProgram)
		*(.text._text)
		*(.text.IntRegister)
		*(.text.GPIOPinWrite)
		*(.text.SysCtlPeripheralDisable)
		*(.text.SysCtlPeripheralReady)
		*(.text.GPIODirModeSet)
		*(.text.__bootrom_size__)
		*(.text.GPIOPinConfigure)
		*(.text.__approm_start__)
		*(.text._ldata)
		*(.text.UARTCharGetNonBlocking)
		*(.text.UARTCharGet)
		*(.text.SysCtlClockGet)
		*(.text.UARTConfigSetExpClk)
		*(.text.__approm_size__)
		*(.text.g_ppui32GPIOIntMapSnowflake)
		*(.text.g_pfnRAMVectors)
		*(.text.FlashErase)
		*(.text.__shared_size__)
		*(.text.UARTEnable)
		*(.text.led_setup)
		*(.text._bss)
		*(.text.UARTDisable)
		*(.text.g_sXTALtoMEMTIM)
        *(.rodata*)
        _etext = .;
    } > SHARED

/DISCARD/ :{
		*(.text.USBDevEndpointDataAck)
		*(.text.TimerIntEnable)
		*(.text.EPIConfigSDRAMSet)
		*(.text.LCDRasterEnabled)
		*(.text.DESDMADisable)
		*(.text.USBEndpointDataGet)
		*(.text.USBFIFOConfigSet)
		*(.text.ADCSequenceStepConfigure)
		*(.text.Crc16Array3)
		*(.text.ComparatorIntClear)
		*(.text.CPUprimask)
		*(.text.SysCtlResetCauseClear)
		*(.text.HibernateIsActive)
		*(.text.SHAMD5Reset)
		*(.text.EPIPSRAMConfigRegGetNonBlocking)
		*(.text.HibernateWakeGet)
		*(.text.I2CLoopbackEnable)
		*(.text.I2CSlaveEnable)
		*(.text.I2CSlaveIntClearEx)
		*(.text.PWMGenFaultClear)
		*(.text.UARTIntStatus)
		*(.text.PWMGenIntClear)
		*(.text.I2CMasterIntClearEx)
		*(.text.EPINonBlockingReadCount)
		*(.text.GPIOIntEnable)
		*(.text.TimerUpdateMode)
		*(.text.uDMADisable)
		*(.text.ADCComparatorReset)
		*(.text.TimerDMAEventGet)
		*(.text.TimerControlStall)
		*(.text.SysCtlIntDisable)
		*(.text.WatchdogResetDisable)
		*(.text.SHAMD5DMAEnable)
		*(.text.QEIPositionGet)
		*(.text.USBULPIRegWrite)
		*(.text.PWMOutputUpdateMode)
		*(.text.SysCtlLDODeepSleepGet)
		*(.text.HibernateClockConfig)
		*(.text.EPIIntDisable)
		*(.text.CANIntUnregister)
		*(.text.USBDMANumChannels)
		*(.text.EMACPHYWrite)
		*(.text.EMACRxDisable)
		*(.text.FlashUserGet)
		*(.text.PWMGenFaultStatus)
		*(.text.HibernateRTCMatchSet)
		*(.text.SSIDisable)
		*(.text.UARTFlowControlGet)
		*(.text.uDMAIntRegister)
		*(.text.I2CMasterIntEnableEx)
		*(.text.USBEndpointDMAEnable)
		*(.text.SSIConfigSetExpClk)
		*(.text._SysCtlMemTimingGet)
		*(.text.g_ppui32SSIIntMapSnowflake)
		*(.text.EPIIntStatus)
		*(.text.MPURegionEnable)
		*(.text.LCDRasterTimingSet)
		*(.text.QEIVelocityDisable)
		*(.text.CANIntEnable)
		*(.text.EPIWriteFIFOCountGet)
		*(.text.PWMIntStatus)
		*(.text.USBHostPwrEnable)
		*(.text._EEPROMSectorMaskSet)
		*(.text.USBEndpointDMADisable)
		*(.text.ADCReferenceGet)
		*(.text.UARTTxIntModeGet)
		*(.text.GPIOPinTypeCAN)
		*(.text.EMACRxDMACurrentBufferGet)
		*(.text.OneWireInit)
		*(.text.SysCtlLDOSleepGet)
		*(.text.WatchdogRunning)
		*(.text.USBLPMIntDisable)
		*(.text.uDMAChannelSelectSecondary)
		*(.text.PWMOutputInvert)
		*(.text.EPIConfigHB8CSSet)
		*(.text.SysCtlDeepSleep)
		*(.text.EPINonBlockingReadStart)
		*(.text.DESIntDisable)
		*(.text.EMACIntEnable)
		*(.text.g_pui32EnRegs)
		*(.text.uDMAErrorStatusGet)
		*(.text.AESTagRead)
		*(.text.OneWireIntEnable)
		*(.text.TimerDisable)
		*(.text.WatchdogResetEnable)
		*(.text.uDMAChannelAttributeDisable)
		*(.text.FPURoundingModeSet)
		*(.text._OneWireIntNumberGet)
		*(.text.SysCtlSRAMSizeGet)
		*(.text.USBControllerVersion)
		*(.text.USBDMAChannelIntEnable)
		*(.text.EEPROMRead)
		*(.text.OneWireBusReset)
		*(.text.USBULPIDisable)
		*(.text.HibernateTamperStatusGet)
		*(.text.g_pui32Crc32)
		*(.text.AESIntClear)
		*(.text.EMACTimestampPPSCommand)
		*(.text.UARTClockSourceGet)
		*(.text.UARTModemStatusGet)
		*(.text.USBEndpointDataSend)
		*(.text.LCDIntUnregister)
		*(.text.SysCtlVCOGet)
		*(.text.EPINonBlockingReadGet16)
		*(.text.SSIIntStatus)
		*(.text.I2CSlaveDisable)
		*(.text.USBDevDisconnect)
		*(.text.EEPROMBlockProtectSet)
		*(.text.FlashAllUserRegisterGet)
		*(.text.SHAMD5IntDisable)
		*(.text.EMACConfigGet)
		*(.text.TimerLoadSet64)
		*(.text.g_ui8SSIIntMapSnowflakeRows)
		*(.text.USBULPIConfig)
		*(.text.uDMAControlAlternateBaseGet)
		*(.text.EMACRemoteWakeUpFrameFilterGet)
		*(.text._SysExcIntNumberGet)
		*(.text.GPIOIntRegister)
		*(.text.UARTClockSourceSet)
		*(.text.HibernateRTCTrimGet)
		*(.text.HibernateTamperDisable)
		*(.text.SSIDataPut)
		*(.text.SysCtlPeripheralReset)
		*(.text.USBDMAChannelStatusClear)
		*(.text.SysExcIntClear)
		*(.text.HibernateLowBatGet)
		*(.text.GPIOPinTypeWakeLow)
		*(.text.ADCBusy)
		*(.text.HibernateTamperEventsClearNoLock)
		*(.text.UARTIntClear)
		*(.text.EMACPHYMMDRead)
		*(.text.USBDevLPMEnable)
		*(.text._EEPROMSectorMaskClear)
		*(.text.EEPROMBlockHide)
		*(.text.EEPROMStatusGet)
		*(.text.SysCtlReset)
		*(.text.HibernateIntUnregister)
		*(.text.PWMOutputFaultLevel)
		*(.text.USBDevLPMDisable)
		*(.text.UARTSmartCardEnable)
		*(.text.PWMGenPeriodGet)
		*(.text.g_i8I2CIntMapSnowflakeRows)
		*(.text.I2CMasterInitExpClk)
		*(.text.FlashUserSet)
		*(.text.SysCtlFlashSectorSizeGet)
		*(.text.USBLPMIntStatus)
		*(.text.SysCtlMOSCConfigSet)
		*(.text.EPIConfigHB16CSSet)
		*(.text._HibernateWriteComplete)
		*(.text._PWMGenIntNumberGet)
		*(.text.EMACRxWatchdogTimerSet)
		*(.text.AESKey1Set)
		*(.text.SysTickEnable)
		*(.text.GPIOPinRead)
		*(.text.I2CTxFIFOFlush)
		*(.text.IntPendClear)
		*(.text.PWMSyncTimeBase)
		*(.text.EMACVLANRxConfigGet)
		*(.text.GPIOPinTypeHibernateRTCCLK)
		*(.text.uDMAEnable)
		*(.text.EPIIntEnable)
		*(.text.EEPROMSizeGet)
		*(.text.UARTSmartCardDisable)
		*(.text.SysCtlDeepSleepClockSet)
		*(.text.AESDMADisable)
		*(.text.USBHostEndpointSpeed)
		*(.text.DESLengthSet)
		*(.text.LCDRasterFrameBufferSet)
		*(.text.EPINonBlockingReadConfigure)
		*(.text.ComparatorIntStatus)
		*(.text.CANMessageClear)
		*(.text.TimerMatchSet)
		*(.text.SHAMD5ConfigSet)
		*(.text.uDMAChannelRequest)
		*(.text.EMACIntRegister)
		*(.text.GPIOPinTypeDIVSCLK)
		*(.text.LCDRasterConfigSet)
		*(.text.WatchdogStallEnable)
		*(.text.EMACTimestampTargetIntEnable)
		*(.text.FPUStackingEnable)
		*(.text.I2CSlaveIntStatus)
		*(.text.g_pui32Regs)
		*(.text.EMACIntStatus)
		*(.text.SysTickIntUnregister)
		*(.text.SysCtlUSBPLLDisable)
		*(.text.HibernateTamperEventsGet)
		*(.text.WatchdogReloadGet)
		*(.text._IntDefaultHandler)
		*(.text.CPUcpsid)
		*(.text.GPIOPinTypeQEI)
		*(.text.ADCSequenceDMADisable)
		*(.text.EMACTimestampPPSCommandModeSet)
		*(.text.FPUFlushToZeroModeSet)
		*(.text.HibernateCalendarMatchGet)
		*(.text.UARTDisableSIR)
		*(.text.SysCtlPeripheralSleepDisable)
		*(.text.USBFIFOAddrGet)
		*(.text.EPIIntErrorStatus)
		*(.text.WatchdogLockState)
		*(.text.I2CMasterErr)
		*(.text.AESIVSet)
		*(.text.g_ppui32UARTIntMapSnowflake)
		*(.text.HibernateRTCEnable)
		*(.text.CANIntClear)
		*(.text.AESConfigSet)
		*(.text.HibernateCalendarMatchSet)
		*(.text.I2CSlaveInit)
		*(.text.g_ui8UARTIntMapRows)
		*(.text.SysCtlDeepSleepClockConfigSet)
		*(.text.UARTModemControlClear)
		*(.text.LCDRasterEnable)
		*(.text.g_pui32Dii16Regs)
		*(.text.LCDIDDDataWrite)
		*(.text.g_ui8TimerIntMapRowsSnowflake)
		*(.text.ADCIntClearEx)
		*(.text.g_pui32Priority)
		*(.text.PWMGenPeriodSet)
		*(.text.IntIsEnabled)
		*(.text.PWMFaultIntUnregister)
		*(.text.USBModeGet)
		*(.text.EMACRxDMAPollDemand)
		*(.text.GPIOPinTypeLCD)
		*(.text.DESReset)
		*(.text.IntTrigger)
		*(.text.GPIOPinTypeGPIOOutputOD)
		*(.text.EMACVLANHashFilterGet)
		*(.text.GPIOIntTypeGet)
		*(.text.GPIOIntUnregisterPin)
		*(.text.SysTickValueGet)
		*(.text.TimerControlWaitOnTrigger)
		*(.text.EMACPowerManagementStatusGet)
		*(.text._USBIndexRead)
		*(.text.WatchdogIntEnable)
		*(.text.USBNumEndpointsGet)
		*(.text.CRCConfigSet)
		*(.text.QEIVelocityConfigure)
		*(.text.SSIIntDisable)
		*(.text.g_pui8Crc8CCITT)
		*(.text.WatchdogStallDisable)
		*(.text.OneWireIntRegister)
		*(.text.GPIOPinTypeUSBDigital)
		*(.text.I2CMasterSlaveAddrSet)
		*(.text.GPIODMATriggerDisable)
		*(.text.USBHostEndpointConfig)
		*(.text.I2CMasterIntEnable)
		*(.text.ADCSoftwareOversampleDataGet)
		*(.text.EPIConfigGPModeSet)
		*(.text.OneWireDataGetNonBlocking)
		*(.text.SSIClockSourceSet)
		*(.text.USBDevSpeedGet)
		*(.text.I2CMasterControl)
		*(.text.UARTIntEnable)
		*(.text.LCDIDDCommandWrite)
		*(.text.TimerEnable)
		*(.text.DESIntEnable)
		*(.text.SysTickIntDisable)
		*(.text.TimerIntClear)
		*(.text.ADCIntDisableEx)
		*(.text.WatchdogIntTypeSet)
		*(.text.FlashIntUnregister)
		*(.text.EMACDMAStateGet)
		*(.text.LCDModeSet)
		*(.text.EMACIntClear)
		*(.text.HibernateRTCSSGet)
		*(.text.UARTDMAEnable)
		*(.text.EEPROMBlockUnlock)
		*(.text.GPIOIntUnregister)
		*(.text.LCDIDDDataRead)
		*(.text.SHAMD5DataProcess)
		*(.text.FlashProtectGet)
		*(.text.SysCtlClockFreqSet)
		*(.text.HibernateIntRegister)
		*(.text.I2CFIFODataPutNonBlocking)
		*(.text.UARTDMADisable)
		*(.text.GPIOPinWakeStatus)
		*(.text.EMACTimestampDisable)
		*(.text.OneWireIntDisable)
		*(.text.SHAMD5HMACPPKeyGenerate)
		*(.text.SysCtlFlashSizeGet)
		*(.text.UART9BitAddrSend)
		*(.text.AESDataAuth)
		*(.text.GPIOIntClear)
		*(.text.ADCSequenceOverflowClear)
		*(.text.EMACTxDMADescriptorListSet)
		*(.text.PWMGenIntRegister)
		*(.text.SSIAdvDataPutFrameEnd)
		*(.text.USBLPMLinkStateGet)
		*(.text.LCDRasterPaletteSet)
		*(.text.USBHostSpeedGet)
		*(.text._USBIndexWrite)
		*(.text.QEIFilterEnable)
		*(.text.g_ppui32I2CIntMap)
		*(.text.g_pui32PendRegs)
		*(.text._SSIIntNumberGet)
		*(.text.CANRetryGet)
		*(.text.USBIntUnregister)
		*(.text.AESKey3Set)
		*(.text.OneWireDataGet)
		*(.text.ADCSequenceDMAEnable)
		*(.text.SysCtlDeepSleepPowerSet)
		*(.text.IntMasterDisable)
		*(.text.EMACInit)
		*(.text.EMACTxEnable)
		*(.text.PWMGenFaultTriggerGet)
		*(.text.TimerLoadGet)
		*(.text.HibernateRTCMatchGet)
		*(.text.HibernateTamperExtOscValid)
		*(.text.UARTFIFOLevelSet)
		*(.text.AESIntUnregister)
		*(.text.SHAMD5DMADisable)
		*(.text.SSIAdvModeSet)
		*(.text.CRCDataWrite)
		*(.text.LCDRasterDisable)
		*(.text.UART9BitEnable)
		*(.text.EMACTxDMACurrentBufferGet)
		*(.text.USBDMAChannelIntStatus)
		*(.text.WatchdogLock)
		*(.text.I2CSlaveIntEnable)
		*(.text.EPIWorkaroundWordRead)
		*(.text.AESDataReadNonBlocking)
		*(.text.PWMDeadBandEnable)
		*(.text.SysCtlVoltageEventStatus)
		*(.text.g_pui32UnpendRegs)
		*(.text.EMACRxEnable)
		*(.text.EMACLPIConfig)
		*(.text.I2CSlaveDataGet)
		*(.text.SysTickIntRegister)
		*(.text.SSILoopbackDisable)
		*(.text.GPIOPinTypeEPI)
		*(.text.AESIntStatus)
		*(.text.USBDMAChannelStatus)
		*(.text._USBIntNumberGet)
		*(.text.uDMAControlBaseGet)
		*(.text.I2CMasterTimeoutSet)
		*(.text.I2CMasterBusBusy)
		*(.text.GPIOPadConfigGet)
		*(.text.UARTRxErrorClear)
		*(.text.USBHostAddrGet)
		*(.text.uDMAChannelAttributeGet)
		*(.text.EEPROMProgram)
		*(.text.SHAMD5IntUnregister)
		*(.text.uDMAIntStatus)
		*(.text.FPUDisable)
		*(.text.UARTLoopbackEnable)
		*(.text.USBHostLPMSend)
		*(.text.QEIIntStatus)
		*(.text.HibernateCalendarSet)
		*(.text.g_ui16CANBitValues)
		*(.text.EMACTimestampIntStatus)
		*(.text.EMACRxDMADescriptorListSet)
		*(.text.SSIIntRegister)
		*(.text.UARTParityModeSet)
		*(.text.SysExcIntEnable)
		*(.text.uDMAChannelControlSet)
		*(.text.USBDMAChannelIntDisable)
		*(.text.USBHostEndpointDataToggle)
		*(.text.LCDRasterSubPanelDisable)
		*(.text.EMACLPILinkSet)
		*(.text.EMACAddrGet)
		*(.text.LCDDMAConfigSet)
		*(.text.AESDataProcessAuth)
		*(.text.SHAMD5IntStatus)
		*(.text.SysTickPeriodGet)
		*(.text.SHAMD5DataWrite)
		*(.text._TimerIntNumberGet)
		*(.text.TimerRTCEnable)
		*(.text.OneWireIntUnregister)
		*(.text.GPIOPinTypeADC)
		*(.text.I2CFIFODataGet)
		*(.text.ADCClockConfigSet)
		*(.text.USBHostEndpointPing)
		*(.text._GPIOIntNumberGet)
		*(.text.HibernateTamperUnLock)
		*(.text.USBHostResume)
		*(.text.I2CSlaveAddressSet)
		*(.text.SysCtlVoltageEventConfig)
		*(.text.GPIODirModeGet)
		*(.text.GPIOPinTypeGPIOInput)
		*(.text.ADCHardwareOversampleConfigure)
		*(.text.PWMGenIntUnregister)
		*(.text.PWMFaultIntRegister)
		*(.text.FlashProtectSet)
		*(.text.QEIEnable)
		*(.text.QEIErrorGet)
		*(.text.UARTEnableSIR)
		*(.text.SSIDataGet)
		*(.text.UARTParityModeGet)
		*(.text.USBHostPwrFaultDisable)
		*(.text.WatchdogReloadSet)
		*(.text.TimerPrescaleGet)
		*(.text.USBPHYPowerOff)
		*(.text.HibernateRTCSSMatchSet)
		*(.text.USBHighSpeed)
		*(.text.UARTBusy)
		*(.text.EMACPHYPowerOn)
		*(.text.ADCComparatorIntStatus)
		*(.text.QEIIntRegister)
		*(.text.EPIAddressMapSet)
		*(.text.EMACHashFilterBitCalculate)
		*(.text.EPIConfigHB16TimingSet)
		*(.text.MPURegionGet)
		*(.text.ADCComparatorRegionSet)
		*(.text.SysCtlSleepPowerSet)
		*(.text.CANIntStatus)
		*(.text.HibernateBatCheckDone)
		*(.text.EMACRxDMACurrentDescriptorGet)
		*(.text.Crc16Array)
		*(.text.ADCSoftwareOversampleConfigure)
		*(.text.ADCPhaseDelaySet)
		*(.text.I2CSlaveACKValueSet)
		*(.text.EMACLPIStatus)
		*(.text.TimerValueGet)
		*(.text.USBEndpointStatus)
		*(.text.EMACRxDMADescriptorListGet)
		*(.text.I2CRxFIFOConfigSet)
		*(.text.uDMAChannelTransferSet)
		*(.text.HibernateRequest)
		*(.text.SHAMD5IntRegister)
		*(.text._PWMFaultIntNumberGet)
		*(.text.TimerClockSourceGet)
		*(.text.AESDataRead)
		*(.text._CANIntNumberGet)
		*(.text.OneWireTransaction)
		*(.text.USBDMAChannelAddressSet)
		*(.text.EMACPowerManagementControlGet)
		*(.text._HibernateCalendarSet)
		*(.text.EPIPSRAMConfigRegRead)
		*(.text.AESDataProcess)
		*(.text.USBHostPwrDisable)
		*(.text.FPUEnable)
		*(.text.ComparatorIntRegister)
		*(.text.CANBitRateSet)
		*(.text.USBDevEndpointStatusClear)
		*(.text.EMACTxDisable)
		*(.text.USBHostEndpointStatusClear)
		*(.text.TimerPrescaleMatchGet)
		*(.text.EPIIntRegister)
		*(.text.LCDIntDisable)
		*(.text.SysCtlIntClear)
		*(.text.SHAMD5ResultRead)
		*(.text.EPIDMATxCount)
		*(.text.ComparatorConfigure)
		*(.text.HibernateIntClear)
		*(.text.OneWireIntStatus)
		*(.text.QEIDisable)
		*(.text.TimerClockSourceSet)
		*(.text.SysCtlPeripheralDeepSleepDisable)
		*(.text.LCDIDDIndexedWrite)
		*(.text.HibernateRTCSet)
		*(.text.CANDisable)
		*(.text.EEPROMMassErase)
		*(.text.UARTModemControlSet)
		*(.text.ADCSequenceDataGet)
		*(.text.HibernateDisable)
		*(.text.HibernateTamperIOEnable)
		*(.text.ADCClockConfigGet)
		*(.text.USBLPMRemoteWakeEnabled)
		*(.text.UARTIntUnregister)
		*(.text.ADCReferenceSet)
		*(.text.AESDataWrite)
		*(.text.EMACLPILinkClear)
		*(.text.g_ui8TimerIntMapRows)
		*(.text.I2CIntUnregister)
		*(.text.I2CMasterLineStateGet)
		*(.text.GPIOADCTriggerEnable)
		*(.text.GPIOPinTypeI2CSCL)
		*(.text.I2CMasterIntStatus)
		*(.text.uDMAIntClear)
		*(.text.USBHostAddrSet)
		*(.text.USBEndpointDataAvail)
		*(.text.IntPriorityGroupingGet)
		*(.text.ComparatorRefSet)
		*(.text.USBOTGSessionRequest)
		*(.text.QEIVelocityEnable)
		*(.text.WatchdogEnable)
		*(.text.I2CRxFIFOFlush)
		*(.text.PWMGenEnable)
		*(.text.uDMAChannelSizeGet)
		*(.text.I2CMasterDataGet)
		*(.text.LCDIDDIndexedRead)
		*(.text.USBULPIEnable)
		*(.text.I2CMasterBurstCountGet)
		*(.text.GPIOPinTypeSSI)
		*(.text.PWMFaultIntClear)
		*(.text.USBHostHubAddrSet)
		*(.text.EMACTxDMACurrentDescriptorGet)
		*(.text.SSIDMADisable)
		*(.text._SysCtlFrequencyGet)
		*(.text.USBDMAChannelDisable)
		*(.text.EEPROMInit)
		*(.text.g_pui32FMPRERegs)
		*(.text.LCDIDDStatusRead)
		*(.text.I2CMasterIntStatusEx)
		*(.text.EEPROMBlockPasswordSet)
		*(.text.HibernateTamperExtOscRecover)
		*(.text.SysCtlIntStatus)
		*(.text.SysCtlNMIClear)
		*(.text.EPINonBlockingReadStop)
		*(.text.HibernateTamperLock)
		*(.text.HibernateEnableExpClk)
		*(.text.uDMAChannelAssign)
		*(.text.FlashIntStatus)
		*(.text.MPUIntUnregister)
		*(.text.EPIModeSet)
		*(.text.ADCComparatorConfigure)
		*(.text.g_ppui32TimerIntMapSnowflake)
		*(.text.LCDIDDDMADisable)
		*(.text.HibernateCalendarGet)
		*(.text.uDMAChannelIsEnabled)
		*(.text.DESIntStatus)
		*(.text.EPIIntUnregister)
		*(.text.EMACTxDMAPollDemand)
		*(.text.EEPROMBlockLock)
		*(.text.HibernateGPIORetentionGet)
		*(.text.ComparatorIntDisable)
		*(.text.EMACTxDMADescriptorListGet)
		*(.text.IntMasterEnable)
		*(.text.USBEndpointPacketCountSet)
		*(.text.ADCSequenceDisable)
		*(.text.EPINonBlockingReadAvail)
		*(.text.SHAMD5IntClear)
		*(.text.AESKey2Set)
		*(.text.FlashAllUserRegisterSet)
		*(.text.LCDIDDTimingSet)
		*(.text.SysExcIntRegister)
		*(.text.MPUIntRegister)
		*(.text.ComparatorIntUnregister)
		*(.text.FPUStackingDisable)
		*(.text.LCDRasterSubPanelConfigSet)
		*(.text.UARTFIFODisable)
		*(.text.ADCSequenceUnderflow)
		*(.text.HibernateBatCheckStart)
		*(.text.EMACHashFilterGet)
		*(.text.USBHostMode)
		*(.text.SysCtlPeripheralDeepSleepEnable)
		*(.text.USBDevMode)
		*(.text.CANMessageSet)
		*(.text.SSIAdvFrameHoldEnable)
		*(.text.TimerIntRegister)
		*(.text._EPIIntNumberGet)
		*(.text.SHAMD5HMACPPKeySet)
		*(.text.WatchdogIntStatus)
		*(.text.TimerMatchSet64)
		*(.text.TimerConfigure)
		*(.text.CRCDataProcess)
		*(.text.EPIDividerCSSet)
		*(.text.EMACTimestampTargetIntDisable)
		*(.text.g_ppui32I2CIntMapSnowflake)
		*(.text.SysCtlLDOSleepSet)
		*(.text.AESAuthLengthSet)
		*(.text.SysCtlPeripheralClockGating)
		*(.text.EMACPHYExtendedWrite)
		*(.text.IntDisable)
		*(.text.PWMPulseWidthSet)
		*(.text.EPIWorkaroundHWordWrite)
		*(.text.g_ppui32SSIIntMap)
		*(.text.QEIIntClear)
		*(.text.uDMAChannelScatterGatherSet)
		*(.text.OneWireIntClear)
		*(.text.HibernateGPIORetentionDisable)
		*(.text.SysCtlLDODeepSleepSet)
		*(.text.AESIntRegister)
		*(.text.I2CMasterBurstLengthSet)
		*(.text.TimerLoadGet64)
		*(.text.CANIntDisable)
		*(.text.FlashIntRegister)
		*(.text.SysExcIntStatus)
		*(.text.USBIntStatusEndpoint)
		*(.text.ADCIntStatus)
		*(.text.IntPriorityGroupingSet)
		*(.text.EMACAddrFilterGet)
		*(.text.USBIntEnableControl)
		*(.text.PWMIntEnable)
		*(.text.I2CIntRegister)
		*(.text.USBHostHubAddrGet)
		*(.text.EMACFrameFilterGet)
		*(.text.EMACVLANRxConfigSet)
		*(.text.I2CFIFODataPut)
		*(.text.SSIIntClear)
		*(.text.CRCSeedSet)
		*(.text.EMACReset)
		*(.text.TimerADCEventSet)
		*(.text.GPIOIntDisable)
		*(.text.USBDevAddrGet)
		*(.text.GPIOPinTypeOneWire)
		*(.text.PWMOutputFault)
		*(.text.ADCSequenceConfigure)
		*(.text.TimerIntUnregister)
		*(.text.Crc32)
		*(.text.SHAMD5HashLengthSet)
		*(.text.g_i8I2CIntMapRows)
		*(.text.PWMPulseWidthGet)
		*(.text.I2CSlaveStatus)
		*(.text.CRCResultRead)
		*(.text.TimerLoadSet)
		*(.text.HibernateIntStatus)
		*(.text.DESIVSet)
		*(.text.EMACPHYPowerOff)
		*(.text.PWMSyncUpdate)
		*(.text.USBClockDisable)
		*(.text.IntPriorityMaskGet)
		*(.text.EEPROMIntEnable)
		*(.text.EMACTimestampAddendSet)
		*(.text.ADCComparatorIntDisable)
		*(.text.EMACTimestampPPSPeriodSet)
		*(.text.LCDClockReset)
		*(.text.EMACVLANHashFilterSet)
		*(.text.g_pi16MIIClockDiv)
		*(.text.I2CMasterEnable)
		*(.text.EEPROMBlockCountGet)
		*(.text.CPUwfi)
		*(.text.FPUNaNModeSet)
		*(.text.EMACStatusGet)
		*(.text.HibernateRTCGet)
		*(.text.EEPROMIntDisable)
		*(.text._UARTIntNumberGet)
		*(.text.USBIntRegister)
		*(.text.DESConfigSet)
		*(.text.HibernateGPIORetentionEnable)
		*(.text.I2CFIFODataGetNonBlocking)
		*(.text.EEPROMProgramNonBlocking)
		*(.text.TimerValueGet64)
		*(.text.USBDMAChannelAddressGet)
		*(.text.SysCtlVoltageEventClear)
		*(.text.EPIConfigHB16Set)
		*(.text.g_pui8OversampleFactor)
		*(.text.EMACTimestampTargetSet)
		*(.text.AESIntEnable)
		*(.text.EPINonBlockingReadGet8)
		*(.text.PWMGenFaultConfigure)
		*(.text.EPINonBlockingReadGet32)
		*(.text.USBIntEnableEndpoint)
		*(.text.LCDRasterACBiasIntCountSet)
		*(.text._CANDataRegWrite)
		*(.text.HibernateCounterMode)
		*(.text.OneWireDMADisable)
		*(.text.QEIDirectionGet)
		*(.text.SysCtlIntEnable)
		*(.text.CANStatusGet)
		*(.text.LCDIntClear)
		*(.text.GPIOPinTypeI2C)
		*(.text.I2CSlaveDataPut)
		*(.text.UARTCharsAvail)
		*(.text.USBDevEndpointStallClear)
		*(.text.QEIIntEnable)
		*(.text.MPURegionDisable)
		*(.text.I2CSlaveFIFOEnable)
		*(.text.FlashIntDisable)
		*(.text.USBHostSuspend)
		*(.text.USBHostReset)
		*(.text.USBEndpointDMAConfigSet)
		*(.text.OneWireBusStatus)
		*(.text.USBDevAddrSet)
		*(.text.HibernateTamperEventsConfig)
		*(.text.PWMIntDisable)
		*(.text.SysCtlPeripheralPowerOff)
		*(.text.TimerMatchGet64)
		*(.text.USBLPMEndpointGet)
		*(.text.UARTRxErrorGet)
		*(.text.EPIConfigHB8TimingSet)
		*(.text.UART9BitAddrSet)
		*(.text.EMACWoLEnter)
		*(.text.PWMDeadBandDisable)
		*(.text.CANIntRegister)
		*(.text.EMACTimestampConfigGet)
		*(.text.USBFIFOFlush)
		*(.text.IntUnregister)
		*(.text.HibernateLowBatSet)
		*(.text.I2CSlaveIntClear)
		*(.text.USBHostPwrFaultEnable)
		*(.text.EMACTimestampConfigSet)
		*(.text._EEPROMWaitForDone)
		*(.text.AESReset)
		*(.text.USBDevLPMConfig)
		*(.text.USBHostRequestINClear)
		*(.text.ADCSequenceUnderflowClear)
		*(.text.PWMGenIntStatus)
		*(.text.I2CTxFIFOConfigSet)
		*(.text.SysCtlGPIOAHBEnable)
		*(.text.ADCPhaseDelayGet)
		*(.text.GPIOPinTypeComparator)
		*(.text.UARTModemControlGet)
		*(.text.EMACNumAddrGet)
		*(.text.EPIWorkaroundHWordRead)
		*(.text.GPIOPinTypePWM)
		*(.text.UARTSpaceAvail)
		*(.text.uDMAChannelAttributeEnable)
		*(.text.USBLPMIntEnable)
		*(.text.USBDMAChannelEnable)
		*(.text.GPIOIntTypeSet)
		*(.text.I2CSlaveIntDisableEx)
		*(.text.TimerRTCDisable)
		*(.text._ADCIntNumberGet)
		*(.text.CANBitTimingGet)
		*(.text.SHAMD5HMACKeySet)
		*(.text.TimerSynchronize)
		*(.text.uDMAChannelSelectDefault)
		*(.text.uDMAChannelModeGet)
		*(.text.HibernateDataSet)
		*(.text.CPUbasepriGet)
		*(.text.SSIDataPutNonBlocking)
		*(.text.USBFIFOConfigGet)
		*(.text.SHAMD5DataWriteNonBlocking)
		*(.text.EMACTimestampEnable)
		*(.text.EMACPHYMMDWrite)
		*(.text.DESIntUnregister)
		*(.text.GPIOPinTypeComparatorOutput)
		*(.text.g_pui16Crc16)
		*(.text.USBIntDisableEndpoint)
		*(.text.QEIConfigure)
		*(.text.ADCIntRegister)
		*(.text.SysCtlClockOutConfig)
		*(.text.USBHostEndpointDataAck)
		*(.text.USBIntDisableControl)
		*(.text.ComparatorIntEnable)
		*(.text.WatchdogUnlock)
		*(.text.FPUHalfPrecisionModeSet)
		*(.text.USBDevEndpointStall)
		*(.text.WatchdogIntRegister)
		*(.text.I2CSlaveFIFODisable)
		*(.text.ADCIntUnregister)
		*(.text.MPURegionSet)
		*(.text.SHAMD5IntEnable)
		*(.text.SSIAdvFrameHoldDisable)
		*(.text.SSIIntEnable)
		*(.text.UARTCharPutNonBlocking)
		*(.text.USBEndpointDataPut)
		*(.text.SysCtlUSBPLLEnable)
		*(.text.SSIBusy)
		*(.text.ADCIntEnableEx)
		*(.text.IntPriorityGet)
		*(.text._CANDataRegRead)
		*(.text.SysCtlAltClkConfig)
		*(.text.SysCtlResetBehaviorGet)
		*(.text.EMACPHYConfigSet)
		*(.text.GPIOPinTypeWakeHigh)
		*(.text.UARTFIFOEnable)
		*(.text.EPIIntErrorClear)
		*(.text.TimerControlEvent)
		*(.text.ADCComparatorIntEnable)
		*(.text.ADCIntStatusEx)
		*(.text.DESKeySet)
		*(.text.EMACFrameFilterSet)
		*(.text.HibernateTamperEventsClear)
		*(.text.Crc8CCITT)
		*(.text.USBEndpointDMAChannel)
		*(.text.EMACConfigSet)
		*(.text.SysCtlClockSet)
		*(.text.HibernateWakeSet)
		*(.text.CANRetrySet)
		*(.text.HibernateRTCSSMatchGet)
		*(.text.EMACTimestampPPSSimpleModeSet)
		*(.text.I2CSlaveIntDisable)
		*(.text.ADCProcessorTrigger)
		*(.text.HibernateIntEnable)
		*(.text.TimerMatchGet)
		*(.text.FlashAllUserRegisterSave)
		*(.text._SHAMD5DataWriteMultiple)
		*(.text.EMACAddrSet)
		*(.text.GPIOPinTypeTimer)
		*(.text.g_pui32FMPPERegs)
		*(.text.CANErrCntrGet)
		*(.text.MPUDisable)
		*(.text.EMACPHYExtendedRead)
		*(.text.GPIOIntStatus)
		*(.text.TimerIntStatus)
		*(.text.SysExcIntDisable)
		*(.text.uDMAIntUnregister)
		*(.text.TimerADCEventGet)
		*(.text.LCDIntStatus)
		*(.text.UARTIntDisable)
		*(.text.EPIConfigHB8Set)
		*(.text.SSILoopbackEnable)
		*(.text.uDMAChannelDisable)
		*(.text.USBDevEndpointConfigGet)
		*(.text.PWMClockGet)
		*(.text.TimerControlTrigger)
		*(.text.ADCIntEnable)
		*(.text.GPIODMATriggerEnable)
		*(.text.CANBitTimingSet)
		*(.text.EMACPowerManagementControlSet)
		*(.text.USBFrameNumberGet)
		*(.text.CPUbasepriSet)
		*(.text.SysCtlResetBehaviorSet)
		*(.text.USBDMAChannelCountSet)
		*(.text.SysExcIntUnregister)
		*(.text.USBDMAChannelCountGet)
		*(.text.I2CMasterDataPut)
		*(.text.AESDataWriteNonBlocking)
		*(.text.PWMGenIntTrigEnable)
		*(.text.ADCIntClear)
		*(.text.EMACRemoteWakeUpFrameFilterSet)
		*(.text.GPIOPinTypeUSBAnalog)
		*(.text._QEIIntNumberGet)
		*(.text.SysCtlPWMClockSet)
		*(.text.UARTBreakCtl)
		*(.text._I2CIntNumberGet)
		*(.text.SysCtlPIOSCCalibrate)
		*(.text.AESIntDisable)
		*(.text.USBIntStatusControl)
		*(.text.OneWireDMAEnable)
		*(.text.USBHostPwrConfig)
		*(.text.I2CSlaveACKOverride)
		*(.text.SysTickPeriodSet)
		*(.text.UARTConfigGetExpClk)
		*(.text.EMACVLANHashFilterBitCalculate)
		*(.text.EPIWorkaroundByteRead)
		*(.text._HibernateIntNumberGet)
		*(.text.EMACTimestampSysTimeUpdate)
		*(.text.FlashUserSave)
		*(.text.USBModeConfig)
		*(.text.EMACAddrFilterSet)
		*(.text.USBDevEndpointConfigSet)
		*(.text.ADCIntDisable)
		*(.text.EMACHashFilterSet)
		*(.text.EPIWorkaroundByteWrite)
		*(.text.uDMAChannelEnable)
		*(.text.USBDevLPMRemoteWake)
		*(.text.I2CFIFOStatus)
		*(.text.WatchdogValueGet)
		*(.text.SysTickIntEnable)
		*(.text.USBClockEnable)
		*(.text.SysCtlPeripheralPresent)
		*(.text.EPIPSRAMConfigRegSet)
		*(.text.I2CMasterBusy)
		*(.text.g_ui8SSIIntMapRows)
		*(.text.PWMClockSet)
		*(.text.I2CMasterIntDisable)
		*(.text.TimerIntDisable)
		*(.text.USBEndpointDataToggleClear)
		*(.text.PWMGenFaultTriggerSet)
		*(.text.EEPROMIntClear)
		*(.text.UARTFIFOLevelGet)
		*(.text.FPULazyStackingEnable)
		*(.text.I2CMasterGlitchFilterConfigSet)
		*(.text.EEPROMIntStatus)
		*(.text.PWMOutputState)
		*(.text.EPIWorkaroundWordWrite)
		*(.text.SysTickDisable)
		*(.text.UARTFlowControlSet)
		*(.text.USBULPIRegRead)
		*(.text.GPIOADCTriggerDisable)
		*(.text.HibernateIntDisable)
		*(.text.SSIEnable)
		*(.text.DESDataWrite)
		*(.text.DESDMAEnable)
		*(.text.I2CMasterIntDisableEx)
		*(.text.PWMFaultIntClearExt)
		*(.text.EMACIntDisable)
		*(.text.GPIOPinTypeTrace)
		*(.text.UART9BitDisable)
		*(.text.SysCtlPeripheralPowerOn)
		*(.text.DESIntClear)
		*(.text.LCDIDDConfigSet)
		*(.text.SysCtlIntUnregister)
		*(.text.ADCComparatorIntClear)
		*(.text.IntPrioritySet)
		*(.text.EMACTimestampSysTimeSet)
		*(.text.ADCSequenceEnable)
		*(.text.IntEnable)
		*(.text.QEIIntUnregister)
		*(.text.CANMessageGet)
		*(.text.SSIClockSourceGet)
		*(.text.FlashProtectSave)
		*(.text.SSIAdvDataPutFrameEndNonBlocking)
		*(.text.SSIIntUnregister)
		*(.text.I2CSlaveIntStatusEx)
		*(.text.SysCtlDelay)
		*(.text.CANInit)
		*(.text.AESDMAEnable)
		*(.text.UARTIntRegister)
		*(.text.EMACVLANTxConfigGet)
		*(.text.g_ui8UARTIntMapRowsSnowflake)
		*(.text.QEIFilterConfigure)
		*(.text.QEIPositionSet)
		*(.text.HibernateRTCDisable)
		*(.text.FlashIntEnable)
		*(.text.CANEnable)
		*(.text.GPIOPinTypeEthernetMII)
		*(.text.LCDIDDDMAWrite)
		*(.text.TimerControlLevel)
		*(.text.USBHostRequestIN)
		*(.text.DESDataRead)
		*(.text.EEPROMBlockProtectGet)
		*(.text.EMACTimestampSysTimeGet)
		*(.text.EPIFIFOConfig)
		*(.text.TimerDMAEventSet)
		*(.text.IntPendSet)
		*(.text.CPUcpsie)
		*(.text.MPURegionCountGet)
		*(.text.USBPHYPowerOn)
		*(.text.HibernateDataGet)
		*(.text.TimerPrescaleSet)
		*(.text.AESLengthSet)
		*(.text.LCDIntRegister)
		*(.text.I2CMasterIntClear)
		*(.text.EPIPSRAMConfigRegGet)
		*(.text.I2CSlaveIntEnableEx)
		*(.text.DESDataWriteNonBlocking)
		*(.text.PWMGenConfigure)
		*(.text.SysCtlNMIStatus)
		*(.text.SSIDataGetNonBlocking)
		*(.text.GPIOUnlockPin)
		*(.text.QEIFilterDisable)
		*(.text.AESIVRead)
		*(.text.uDMAErrorStatusClear)
		*(.text.QEIIntDisable)
		*(.text.SHAMD5HMACProcess)
		*(.text.EMACPHYRead)
		*(.text.I2CMasterDisable)
		*(.text.HibernateTamperIODisable)
		*(.text.uDMAControlBaseSet)
		*(.text.HibernateRTCTrimSet)
		*(.text.PWMGenDisable)
		*(.text.EMACLPIEnter)
		*(.text.DESDataReadNonBlocking)
		*(.text.USBHostRequestStatus)
		*(.text.g_ppui32UARTIntMap)
		*(.text.PWMGenIntTrigDisable)
		*(.text.SysCtlPeripheralSleepEnable)
		*(.text.MPUEnable)
		*(.text.SysCtlIntRegister)
		*(.text.GPIOIntRegisterPin)
		*(.text.Crc16)
		*(.text.USBHostLPMConfig)
		*(.text.SysCtlSleep)
		*(.text.USBDMAChannelConfigSet)
		*(.text.IntPriorityMaskSet)
		*(.text.USBDevConnect)
		*(.text.DESDataProcess)
		*(.text.USBOTGMode)
		*(.text.HibernateTamperEnable)
		*(.text.g_ppui32TimerIntMap)
		*(.text.ComparatorValueGet)
		*(.text.SSIDMAEnable)
		*(.text.USBHostLPMResume)
		*(.text.GPIOPinTypeEthernetLED)
		*(.text.TimerPrescaleMatchSet)
		*(.text.WatchdogIntUnregister)
		*(.text.ADCSoftwareOversampleStepConfigure)
		*(.text.QEIVelocityGet)
		*(.text.ADCSequenceOverflow)
		*(.text.LCDIntEnable)
		*(.text.LCDRasterSubPanelEnable)
		*(.text.EMACTxFlush)
		*(.text.DESIntRegister)
		*(.text.SysCtlGPIOAHBDisable)
		*(.text.SysCtlResetCauseGet)
		*(.text.UARTTxIntModeSet)
		*(.text.WatchdogIntClear)
		*(.text.EMACVLANTxConfigSet)
		*(.text.EMACIntUnregister)
		*(.text.FlashIntClear)
		*(.text.EPIDividerSet)
		*(.text.SysCtlPWMClockGet)
	}

    .data : AT(ADDR(.text) + SIZEOF(.text))
    {
        _data = .;
        _ldata = LOADADDR (.data);
        *(vtable)
        *(.data*)
        _edata = .;
    } > SRAM

    .bss :
    {
        _bss = .;
        *(.bss*)
        *(COMMON)
        _ebss = .;
    } > SRAM
}
