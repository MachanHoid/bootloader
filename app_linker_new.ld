/******************************************************************************
 *
 * project.ld - Linker configuration file for project.
 *
 * Copyright (c) 2013-2020 Texas Instruments Incorporated.  All rights reserved.
 * Software License Agreement
 * 
 *   Redistribution and use in source and binary forms, with or without
 *   modification, are permitted provided that the following conditions
 *   are met:
 * 
 *   Redistributions of source code must retain the above copyright
 *   notice, this list of conditions and the following disclaimer.
 * 
 *   Redistributions in binary form must reproduce the above copyright
 *   notice, this list of conditions and the following disclaimer in the
 *   documentation and/or other materials provided with the  
 *   distribution.
 * 
 *   Neither the name of Texas Instruments Incorporated nor the names of
 *   its contributors may be used to endorse or promote products derived
 *   from this software without specific prior written permission.
 * 
 * THIS SOFTWARE IS PROVIDED BY THE COPYRIGHT HOLDERS AND CONTRIBUTORS
 * "AS IS" AND ANY EXPRESS OR IMPLIED WARRANTIES, INCLUDING, BUT NOT
 * LIMITED TO, THE IMPLIED WARRANTIES OF MERCHANTABILITY AND FITNESS FOR
 * A PARTICULAR PURPOSE ARE DISCLAIMED. IN NO EVENT SHALL THE COPYRIGHT
 * OWNER OR CONTRIBUTORS BE LIABLE FOR ANY DIRECT, INDIRECT, INCIDENTAL,
 * SPECIAL, EXEMPLARY, OR CONSEQUENTIAL DAMAGES (INCLUDING, BUT NOT
 * LIMITED TO, PROCUREMENT OF SUBSTITUTE GOODS OR SERVICES; LOSS OF USE,
 * DATA, OR PROFITS; OR BUSINESS INTERRUPTION) HOWEVER CAUSED AND ON ANY
 * THEORY OF LIABILITY, WHETHER IN CONTRACT, STRICT LIABILITY, OR TORT
 * (INCLUDING NEGLIGENCE OR OTHERWISE) ARISING IN ANY WAY OUT OF THE USE
 * OF THIS SOFTWARE, EVEN IF ADVISED OF THE POSSIBILITY OF SUCH DAMAGE.
 * 
 * This is part of revision 2.2.0.295 of the Tiva Firmware Development Package.
 *
 *****************************************************************************/

INCLUDE memory_map.ld

SECTIONS
{
    .text :
    {
        _text = .;
        KEEP(*(.isr_vector))

		*(.text.ResetISR)
		*(.text.FaultISR)
		*(.text.main)
		*(.text.g_pfnVectors)
		*(.text.NmiSR)
		*(.text.pui32Stack)
		*(.text.zero_loop)
		*(.text.IntDefaultHandler)
        *(.rodata*)
        _etext = .;
    } > APPROM

/DISCARD/ :{
		*(.text.EMACTimestampAddendSet)
		*(.text.CANBitTimingSet)
		*(.text.PWMGenPeriodGet)
		*(.text.TimerPrescaleSet)
		*(.text.LCDRasterConfigSet)
		*(.text.SHAMD5HMACKeySet)
		*(.text.SysCtlMOSCConfigSet)
		*(.text.HibernateBatCheckDone)
		*(.text.LCDRasterEnabled)
		*(.text.IntPriorityMaskSet)
		*(.text.EMACIntClear)
		*(.text.UART9BitAddrSet)
		*(.text.EPIWorkaroundHWordWrite)
		*(.text.UARTConfigGetExpClk)
		*(.text.GPIOPinRead)
		*(.text.WatchdogIntTypeSet)
		*(.text.WatchdogReloadGet)
		*(.text.SysCtlGPIOAHBDisable)
		*(.text.FPUDisable)
		*(.text.WatchdogIntClear)
		*(.text.USBHostLPMResume)
		*(.text.EMACTxDMADescriptorListSet)
		*(.text.DESDMAEnable)
		*(.text._SysExcIntNumberGet)
		*(.text.I2CMasterBurstLengthSet)
		*(.text.g_pui16Crc16)
		*(.text.ADCSoftwareOversampleConfigure)
		*(.text.EPIDividerSet)
		*(.text.SysCtlLDODeepSleepGet)
		*(.text.OneWireIntDisable)
		*(.text.USBLPMIntStatus)
		*(.text.HibernateBatCheckStart)
		*(.text._TimerIntNumberGet)
		*(.text.GPIOPinWrite)
		*(.text.EMACPowerManagementControlGet)
		*(.text.EMACPowerManagementControlSet)
		*(.text.DESConfigSet)
		*(.text.SSIIntStatus)
		*(.text.FPUStackingDisable)
		*(.text.I2CFIFODataPut)
		*(.text.USBDMAChannelStatus)
		*(.text.EMACTxDMACurrentBufferGet)
		*(.text.TimerEnable)
		*(.text.USBIntDisableControl)
		*(.text.HibernateTamperEventsClear)
		*(.text.ADCSequenceOverflow)
		*(.text.g_ppui32I2CIntMapSnowflake)
		*(.text.SysCtlVoltageEventConfig)
		*(.text.HibernateGPIORetentionEnable)
		*(.text.EMACTimestampConfigSet)
		*(.text.g_pui32FMPPERegs)
		*(.text.EPIDMATxCount)
		*(.text.SysCtlVCOGet)
		*(.text.PWMGenFaultTriggerSet)
		*(.text.USBHostPwrFaultDisable)
		*(.text.ADCSequenceUnderflowClear)
		*(.text._CANDataRegRead)
		*(.text.EMACIntUnregister)
		*(.text.IntIsEnabled)
		*(.text.EMACPHYExtendedRead)
		*(.text.EMACTimestampSysTimeUpdate)
		*(.text.IntDisable)
		*(.text.PWMGenFaultClear)
		*(.text.USBLPMEndpointGet)
		*(.text.UARTFIFODisable)
		*(.text.HibernateTamperEnable)
		*(.text.EMACIntDisable)
		*(.text.UARTCharsAvail)
		*(.text.g_ui32GPIOIntMapBlizzardRows)
		*(.text.ADCSoftwareOversampleDataGet)
		*(.text.HibernateRTCSSMatchSet)
		*(.text.ADCSequenceDMAEnable)
		*(.text.I2CMasterErr)
		*(.text.HibernateDataGet)
		*(.text.USBNumEndpointsGet)
		*(.text.USBDMAChannelAddressSet)
		*(.text.SSIAdvFrameHoldDisable)
		*(.text.USBIntStatusControl)
		*(.text.FlashIntRegister)
		*(.text._etext)
		*(.text.HibernateGPIORetentionGet)
		*(.text.USBOTGSessionRequest)
		*(.text.MPURegionGet)
		*(.text.DESIntEnable)
		*(.text.USBLPMIntEnable)
		*(.text._EPIIntNumberGet)
		*(.text.CPUwfi)
		*(.text.WatchdogIntEnable)
		*(.text.UARTModemStatusGet)
		*(.text.FlashProtectSet)
		*(.text.SysCtlPeripheralEnable)
		*(.text.uDMAErrorStatusClear)
		*(.text.uDMAChannelModeGet)
		*(.text._edata)
		*(.text.QEIErrorGet)
		*(.text.GPIOPinTypeWakeLow)
		*(.text.EMACRxWatchdogTimerSet)
		*(.text.QEIIntDisable)
		*(.text.SSIConfigSetExpClk)
		*(.text.PWMGenIntTrigDisable)
		*(.text.UART9BitEnable)
		*(.text._OneWireIntNumberGet)
		*(.text.FlashIntStatus)
		*(.text.GPIOUnlockPin)
		*(.text.QEIVelocityEnable)
		*(.text.UARTClockSourceGet)
		*(.text.USBULPIDisable)
		*(.text.I2CMasterControl)
		*(.text.I2CSlaveStatus)
		*(.text.I2CMasterBusBusy)
		*(.text.USBHostReset)
		*(.text.USBHostRequestIN)
		*(.text.PWMGenDisable)
		*(.text._PWMFaultIntNumberGet)
		*(.text.I2CSlaveIntDisableEx)
		*(.text.Crc16)
		*(.text.UARTDisable)
		*(.text.ComparatorValueGet)
		*(.text.HibernateCalendarSet)
		*(.text.WatchdogLockState)
		*(.text.ADCSequenceStepConfigure)
		*(.text.HibernateTamperUnLock)
		*(.text.SysCtlNMIClear)
		*(.text.__shared_start__)
		*(.text.I2CRxFIFOFlush)
		*(.text.QEIFilterEnable)
		*(.text.USBHostSuspend)
		*(.text.EPIFIFOConfig)
		*(.text.TimerPrescaleMatchSet)
		*(.text.I2CFIFODataGet)
		*(.text.DESDataWriteNonBlocking)
		*(.text.HibernateTamperDisable)
		*(.text.uDMAIntClear)
		*(.text.I2CSlaveIntClear)
		*(.text.HibernateCalendarGet)
		*(.text.QEIIntStatus)
		*(.text.TimerIntClear)
		*(.text.TimerMatchGet64)
		*(.text.EEPROMBlockProtectGet)
		*(.text.SysTickEnable)
		*(.text.AESKey1Set)
		*(.text.EMACConfigGet)
		*(.text.UARTCharGet)
		*(.text.USBULPIRegRead)
		*(.text.LCDIDDDataRead)
		*(.text.USBHostPwrDisable)
		*(.text.uDMAControlBaseSet)
		*(.text.EPIIntErrorStatus)
		*(.text.UARTIntClear)
		*(.text.LCDIDDDMAWrite)
		*(.text.MPURegionSet)
		*(.text.GPIOIntUnregisterPin)
		*(.text._ebss)
		*(.text.SysCtlSRAMSizeGet)
		*(.text.UARTBreakCtl)
		*(.text.EEPROMInit)
		*(.text.Crc32)
		*(.text.SHAMD5Reset)
		*(.text.AESReset)
		*(.text.QEIVelocityGet)
		*(.text.HibernateIntUnregister)
		*(.text.PWMGenPeriodSet)
		*(.text._EEPROMSectorMaskSet)
		*(.text.TimerMatchSet64)
		*(.text.QEIVelocityConfigure)
		*(.text.USBHostHubAddrGet)
		*(.text.DESDMADisable)
		*(.text.EMACTimestampConfigGet)
		*(.text.I2CFIFOStatus)
		*(.text.SysCtlSleep)
		*(.text.UARTFIFOEnable)
		*(.text.I2CRxFIFOConfigSet)
		*(.text.USBDMAChannelCountGet)
		*(.text.EMACIntRegister)
		*(.text.HibernateIsActive)
		*(.text.uDMAChannelAttributeDisable)
		*(.text.SHAMD5DataProcess)
		*(.text.SysCtlPeripheralPowerOff)
		*(.text.SysTickIntDisable)
		*(.text._I2CIntNumberGet)
		*(.text.GPIOPinTypeADC)
		*(.text.SSIEnable)
		*(.text.USBFrameNumberGet)
		*(.text.WatchdogIntStatus)
		*(.text.CANRetryGet)
		*(.text.PWMPulseWidthGet)
		*(.text.EMACLPILinkSet)
		*(.text.uDMAChannelEnable)
		*(.text.TimerIntEnable)
		*(.text._text)
		*(.text.FlashIntDisable)
		*(.text.UARTClockSourceSet)
		*(.text.EMACPHYPowerOn)
		*(.text.SysCtlIntStatus)
		*(.text.GPIOPinTypeEthernetMII)
		*(.text.USBIntStatusEndpoint)
		*(.text.CPUcpsie)
		*(.text.EPIWorkaroundWordRead)
		*(.text.SSIIntRegister)
		*(.text.PWMGenEnable)
		*(.text.EEPROMBlockPasswordSet)
		*(.text.EEPROMProgram)
		*(.text.ADCSequenceDMADisable)
		*(.text.HibernateTamperIODisable)
		*(.text.delay)
		*(.text.SSIDataGetNonBlocking)
		*(.text.CPUbasepriGet)
		*(.text.I2CSlaveFIFOEnable)
		*(.text._SysCtlFrequencyGet)
		*(.text.OneWireIntStatus)
		*(.text.EMACPHYConfigSet)
		*(.text.GPIOIntUnregister)
		*(.text.GPIOPinTypeI2C)
		*(.text._SHAMD5DataWriteMultiple)
		*(.text.g_pui8Crc8CCITT)
		*(.text.USBHostLPMSend)
		*(.text.UARTEnableSIR)
		*(.text.CPUprimask)
		*(.text.UARTCharPut)
		*(.text.USBHostEndpointPing)
		*(.text.DESIntClear)
		*(.text.UARTBusy)
		*(.text.EMACPHYMMDRead)
		*(.text.DESIVSet)
		*(.text.EMACPHYWrite)
		*(.text.USBDMAChannelStatusClear)
		*(.text.EMACVLANRxConfigGet)
		*(.text.FlashAllUserRegisterSave)
		*(.text.HibernateTamperLock)
		*(.text.FlashIntUnregister)
		*(.text.HibernateRTCEnable)
		*(.text.uDMAChannelIsEnabled)
		*(.text._SSIIntNumberGet)
		*(.text.SSIIntEnable)
		*(.text.g_i8I2CIntMapRows)
		*(.text.GPIOPinTypeEthernetLED)
		*(.text.SSIDMADisable)
		*(.text.USBEndpointDMAConfigSet)
		*(.text.AESDMAEnable)
		*(.text.UARTFIFOLevelGet)
		*(.text.SHAMD5DataWriteNonBlocking)
		*(.text._HibernateWriteComplete)
		*(.text.UARTFIFOLevelSet)
		*(.text.CANInit)
		*(.text.SysCtlUSBPLLDisable)
		*(.text.TimerMatchSet)
		*(.text.TimerRTCDisable)
		*(.text.g_pppui32XTALtoVCO)
		*(.text.HibernateIntClear)
		*(.text.g_pui32Crc32)
		*(.text.GPIOPinTypeUSBAnalog)
		*(.text.CRCDataProcess)
		*(.text.SHAMD5HMACProcess)
		*(.text.g_ui8UARTIntMapRows)
		*(.text.ADCSequenceUnderflow)
		*(.text.I2CMasterBusy)
		*(.text.g_ppui32SSIIntMap)
		*(.text.EMACTimestampDisable)
		*(.text.LCDIDDStatusRead)
		*(.text.LCDDMAConfigSet)
		*(.text.UARTParityModeSet)
		*(.text.ADCIntClear)
		*(.text.CPUcpsid)
		*(.text.HibernateTamperEventsConfig)
		*(.text.CANIntUnregister)
		*(.text.MPUDisable)
		*(.text.SSIAdvDataPutFrameEnd)
		*(.text.EPIConfigHB8CSSet)
		*(.text.TimerLoadSet)
		*(.text.UARTTxIntModeGet)
		*(.text.g_ppui32UARTIntMap)
		*(.text._HibernateIntNumberGet)
		*(.text.ADCIntUnregister)
		*(.text.CANStatusGet)
		*(.text.EMACPHYPowerOff)
		*(.text.EPINonBlockingReadGet16)
		*(.text.I2CIntUnregister)
		*(.text.DESIntStatus)
		*(.text.LCDRasterFrameBufferSet)
		*(.text.TimerControlWaitOnTrigger)
		*(.text.EEPROMIntClear)
		*(.text.USBEndpointDataGet)
		*(.text.SysCtlResetCauseClear)
		*(.text.HibernateIntEnable)
		*(.text.EMACWoLEnter)
		*(.text.EPINonBlockingReadStart)
		*(.text.ADCComparatorIntDisable)
		*(.text.EPIConfigGPModeSet)
		*(.text.USBIntUnregister)
		*(.text.ADCIntEnableEx)
		*(.text.g_ui16CANBitValues)
		*(.text.uDMAIntRegister)
		*(.text.FlashUserSave)
		*(.text.USBDMAChannelEnable)
		*(.text.EMACPHYRead)
		*(.text.USBDMAChannelAddressGet)
		*(.text.TimerMatchGet)
		*(.text.GPIOIntStatus)
		*(.text.PWMOutputUpdateMode)
		*(.text.EPIConfigHB8Set)
		*(.text.EMACLPIEnter)
		*(.text.SysCtlIntDisable)
		*(.text.WatchdogLock)
		*(.text.GPIOPinTypeGPIOInput)
		*(.text.SysExcIntRegister)
		*(.text.EEPROMBlockCountGet)
		*(.text.ADCReferenceSet)
		*(.text.EPINonBlockingReadGet32)
		*(.text.PWMGenFaultConfigure)
		*(.text.EMACTimestampPPSSimpleModeSet)
		*(.text.EEPROMRead)
		*(.text.USBEndpointDataSend)
		*(.text.WatchdogIntUnregister)
		*(.text.SysCtlIntClear)
		*(.text.USBDMAChannelCountSet)
		*(.text.UARTSmartCardDisable)
		*(.text.LCDRasterSubPanelDisable)
		*(.text.EMACAddrGet)
		*(.text.SysExcIntUnregister)
		*(.text.ADCComparatorReset)
		*(.text.I2CMasterIntStatus)
		*(.text.SysCtlLDODeepSleepSet)
		*(.text.UARTParityModeGet)
		*(.text.USBHostLPMConfig)
		*(.text.GPIOPinTypeComparator)
		*(.text.I2CMasterInitExpClk)
		*(.text.SysExcIntClear)
		*(.text.QEIDirectionGet)
		*(.text.SHAMD5DMADisable)
		*(.text.TimerADCEventGet)
		*(.text.USBModeGet)
		*(.text.USBULPIConfig)
		*(.text.EPIConfigHB16TimingSet)
		*(.text.TimerUpdateMode)
		*(.text.TimerValueGet64)
		*(.text.UARTCharGetNonBlocking)
		*(.text.FPUEnable)
		*(.text.USBEndpointDataToggleClear)
		*(.text.TimerControlEvent)
		*(.text.LCDRasterTimingSet)
		*(.text.USBHostPwrEnable)
		*(.text.MPURegionCountGet)
		*(.text.UARTCharPutNonBlocking)
		*(.text.EMACTxFlush)
		*(.text.FlashErase)
		*(.text.EMACTimestampIntStatus)
		*(.text.HibernateTamperExtOscValid)
		*(.text.__bootrom_start__)
		*(.text.ADCSequenceDisable)
		*(.text.EMACTxEnable)
		*(.text.GPIOPinTypePWM)
		*(.text.SysCtlPeripheralClockGating)
		*(.text.EMACRxDMADescriptorListSet)
		*(.text.g_pui32EnRegs)
		*(.text.uDMAChannelTransferSet)
		*(.text.EMACRemoteWakeUpFrameFilterGet)
		*(.text.TimerSynchronize)
		*(.text.LCDIDDConfigSet)
		*(.text.GPIOPinTypeGPIOOutputOD)
		*(.text.USBIntEnableControl)
		*(.text.LCDIntClear)
		*(.text.EMACTimestampSysTimeGet)
		*(.text.LCDIntRegister)
		*(.text.SysCtlDeepSleep)
		*(.text.CRCSeedSet)
		*(.text.USBHostHubAddrSet)
		*(.text.GPIOPinTypeEPI)
		*(.text.LCDIDDIndexedRead)
		*(.text.TimerDMAEventSet)
		*(.text.GPIOPinTypeDIVSCLK)
		*(.text.g_ui8TimerIntMapRows)
		*(.text.PWMClockGet)
		*(.text.EEPROMBlockProtectSet)
		*(.text.I2CMasterIntStatusEx)
		*(.text.UARTModemControlGet)
		*(.text.UART9BitDisable)
		*(.text.GPIOPinTypeTimer)
		*(.text.UART9BitAddrSend)
		*(.text.PWMDeadBandEnable)
		*(.text.__bootrom_size__)
		*(.text.EMACRxDMACurrentBufferGet)
		*(.text.EEPROMIntStatus)
		*(.text.EEPROMProgramNonBlocking)
		*(.text.USBDMAChannelIntStatus)
		*(.text.USBDevLPMConfig)
		*(.text.uDMAControlBaseGet)
		*(.text.EPINonBlockingReadConfigure)
		*(.text.LCDModeSet)
		*(.text.GPIOPinTypeI2CSCL)
		*(.text.I2CMasterIntDisable)
		*(.text.PWMOutputInvert)
		*(.text.CANBitRateSet)
		*(.text.USBEndpointDataPut)
		*(.text.USBModeConfig)
		*(.text.TimerClockSourceSet)
		*(.text.DESKeySet)
		*(.text.I2CMasterIntClear)
		*(.text.EMACTimestampEnable)
		*(.text.USBHostEndpointSpeed)
		*(.text.QEIPositionGet)
		*(.text.USBULPIRegWrite)
		*(.text.TimerADCEventSet)
		*(.text.SysCtlGPIOAHBEnable)
		*(.text.EMACRxDisable)
		*(.text.SysCtlLDOSleepSet)
		*(.text.LCDIDDTimingSet)
		*(.text.PWMGenFaultStatus)
		*(.text.GPIOPinTypeHibernateRTCCLK)
		*(.text.SysCtlResetCauseGet)
		*(.text.ADCIntDisableEx)
		*(.text.USBDevEndpointStallClear)
		*(.text.I2CMasterEnable)
		*(.text.EPIPSRAMConfigRegGetNonBlocking)
		*(.text.USBHostAddrSet)
		*(.text.PWMPulseWidthSet)
		*(.text.QEIIntClear)
		*(.text.AESIntEnable)
		*(.text.EEPROMIntEnable)
		*(.text.SysCtlResetBehaviorGet)
		*(.text.SSILoopbackEnable)
		*(.text.AESIntClear)
		*(.text.PWMGenIntRegister)
		*(.text.USBULPIEnable)
		*(.text.HibernateRTCGet)
		*(.text.uDMAChannelDisable)
		*(.text.SysCtlResetBehaviorSet)
		*(.text.uDMAChannelSizeGet)
		*(.text.I2CTxFIFOFlush)
		*(.text.PWMOutputFault)
		*(.text.PWMSyncUpdate)
		*(.text.USBLPMRemoteWakeEnabled)
		*(.text.EMACPHYExtendedWrite)
		*(.text.AESKey3Set)
		*(.text.PWMGenIntStatus)
		*(.text.ADCIntStatus)
		*(.text.USBHostPwrConfig)
		*(.text.g_ui32GPIOIntMapSnowflakeRows)
		*(.text.SysCtlIntEnable)
		*(.text.led_setup)
		*(.text.FlashUserSet)
		*(.text.LCDRasterPaletteSet)
		*(.text.UARTIntRegister)
		*(.text.WatchdogUnlock)
		*(.text.PWMGenConfigure)
		*(.text.TimerLoadGet)
		*(.text.EMACPHYMMDWrite)
		*(.text.TimerIntUnregister)
		*(.text.USBHostPwrFaultEnable)
		*(.text.EPIWorkaroundHWordRead)
		*(.text.g_ppui32GPIOIntMapSnowflake)
		*(.text.USBLPMIntDisable)
		*(.text.ADCIntClearEx)
		*(.text.ADCPhaseDelaySet)
		*(.text.ComparatorRefSet)
		*(.text.QEIConfigure)
		*(.text.TimerDisable)
		*(.text.EMACRxEnable)
		*(.text.WatchdogResetEnable)
		*(.text.ADCBusy)
		*(.text.USBDMAChannelIntDisable)
		*(.text.HibernateRequest)
		*(.text.USBEndpointDMAEnable)
		*(.text._USBIntNumberGet)
		*(.text.HibernateTamperIOEnable)
		*(.text.AESDataWriteNonBlocking)
		*(.text.GPIOADCTriggerEnable)
		*(.text.ComparatorIntDisable)
		*(.text.SysCtlPeripheralDisable)
		*(.text.SysCtlClockFreqSet)
		*(.text.LCDIntStatus)
		*(.text.USBHostMode)
		*(.text._bss)
		*(.text.SSIAdvDataPutFrameEndNonBlocking)
		*(.text._GPIOIntNumberGet)
		*(.text.g_pui8OversampleFactor)
		*(.text.GPIOPinConfigure)
		*(.text.AESDataRead)
		*(.text.CANMessageGet)
		*(.text.I2CSlaveAddressSet)
		*(.text.USBPHYPowerOff)
		*(.text.GPIOPinTypeUSBDigital)
		*(.text.FlashAllUserRegisterSet)
		*(.text.SysCtlNMIStatus)
		*(.text.IntRegister)
		*(.text.CANIntEnable)
		*(.text.AESIntDisable)
		*(.text.ADCIntStatusEx)
		*(.text.ADCIntEnable)
		*(.text.CANMessageClear)
		*(.text.SysTickDisable)
		*(.text.UARTTxIntModeSet)
		*(.text.GPIOIntRegister)
		*(.text.USBDevEndpointConfigGet)
		*(.text.HibernateDataSet)
		*(.text.USBControllerVersion)
		*(.text.I2CTxFIFOConfigSet)
		*(.text.TimerIntDisable)
		*(.text.EEPROMStatusGet)
		*(.text.I2CLoopbackEnable)
		*(.text.MPUEnable)
		*(.text.EEPROMBlockHide)
		*(.text.OneWireIntUnregister)
		*(.text.UARTEnable)
		*(.text.UARTModemControlClear)
		*(.text._UARTIntNumberGet)
		*(.text.IntTrigger)
		*(.text.OneWireTransaction)
		*(.text.GPIOIntTypeSet)
		*(.text._SysCtlMemTimingGet)
		*(.text.g_pui32UnpendRegs)
		*(.text.SysCtlReset)
		*(.text.EMACAddrFilterGet)
		*(.text.GPIOIntRegisterPin)
		*(.text.HibernateRTCTrimSet)
		*(.text.uDMAIntUnregister)
		*(.text.TimerDMAEventGet)
		*(.text.I2CFIFODataPutNonBlocking)
		*(.text.AESIntUnregister)
		*(.text.HibernateDisable)
		*(.text.I2CSlaveInit)
		*(.text._USBIndexWrite)
		*(.text.AESDataAuth)
		*(.text.USBEndpointStatus)
		*(.text.SysCtlPIOSCCalibrate)
		*(.text.LCDIDDDataWrite)
		*(.text.PWMGenIntUnregister)
		*(.text.AESIVRead)
		*(.text.QEIDisable)
		*(.text.SysCtlFlashSizeGet)
		*(.text.CANIntDisable)
		*(.text.USBIntDisableEndpoint)
		*(.text.EEPROMBlockUnlock)
		*(.text.EMACConfigSet)
		*(.text.USBIntRegister)
		*(.text.QEIIntUnregister)
		*(.text.QEIIntEnable)
		*(.text.g_ui8TimerIntMapRowsSnowflake)
		*(.text.DESIntDisable)
		*(.text.EMACTimestampPPSCommandModeSet)
		*(.text.HibernateTamperStatusGet)
		*(.text.EMACLPIStatus)
		*(.text.AESTagRead)
		*(.text.IntPriorityGet)
		*(.text.UARTIntUnregister)
		*(.text.USBPHYPowerOn)
		*(.text.I2CSlaveIntEnable)
		*(.text.GPIOADCTriggerDisable)
		*(.text.I2CSlaveIntStatus)
		*(.text.EMACStatusGet)
		*(.text.g_ppui32I2CIntMap)
		*(.text.SHAMD5IntRegister)
		*(.text.EMACVLANHashFilterSet)
		*(.text.IntPendClear)
		*(.text.SysCtlPWMClockGet)
		*(.text.ADCComparatorIntEnable)
		*(.text.USBDevDisconnect)
		*(.text.SHAMD5HMACPPKeySet)
		*(.text.led_off)
		*(.text.uDMAChannelSelectDefault)
		*(.text.HibernateRTCMatchSet)
		*(.text.I2CSlaveEnable)
		*(.text.DESDataReadNonBlocking)
		*(.text.EEPROMSizeGet)
		*(.text.QEIFilterConfigure)
		*(.text.USBFIFOConfigGet)
		*(.text.GPIODMATriggerEnable)
		*(.text.USBClockDisable)
		*(.text.IntPriorityGroupingSet)
		*(.text.GPIOIntTypeGet)
		*(.text.SysCtlPeripheralSleepDisable)
		*(.text.FlashAllUserRegisterGet)
		*(.text.CANIntStatus)
		*(.text.ADCSoftwareOversampleStepConfigure)
		*(.text.EMACRxDMAPollDemand)
		*(.text.GPIOPinTypeOneWire)
		*(.text.EMACIntStatus)
		*(.text.LCDClockReset)
		*(.text._HibernateCalendarSet)
		*(.text.USBDevSpeedGet)
		*(.text.EMACAddrSet)
		*(.text.EMACVLANRxConfigSet)
		*(.text.AESAuthLengthSet)
		*(.text.IntUnregister)
		*(.text.SSIDataPutNonBlocking)
		*(.text.PWMGenIntClear)
		*(.text.EPIIntDisable)
		*(.text.I2CMasterDisable)
		*(.text.AESDataProcessAuth)
		*(.text.SysCtlPeripheralDeepSleepEnable)
		*(.text.HibernateRTCTrimGet)
		*(.text.__approm_start__)
		*(.text.IntMasterEnable)
		*(.text.SHAMD5IntEnable)
		*(.text.UARTSpaceAvail)
		*(.text.EMACTimestampTargetSet)
		*(.text.PWMFaultIntRegister)
		*(.text.CANRetrySet)
		*(.text.TimerValueGet)
		*(.text.UARTRxErrorGet)
		*(.text.g_pfnRAMVectors)
		*(.text.EPIIntUnregister)
		*(.text.SysCtlClockOutConfig)
		*(.text._QEIIntNumberGet)
		*(.text.SysTickIntUnregister)
		*(.text.uDMAIntStatus)
		*(.text.GPIOPinTypeWakeHigh)
		*(.text.USBDevConnect)
		*(.text.I2CMasterTimeoutSet)
		*(.text.SHAMD5HMACPPKeyGenerate)
		*(.text.EPIDividerCSSet)
		*(.text.USBHostResume)
		*(.text.g_ppui32UARTIntMapSnowflake)
		*(.text.GPIOPinTypeCAN)
		*(.text.HibernateRTCDisable)
		*(.text.HibernateWakeGet)
		*(.text.SSIClockSourceSet)
		*(.text.SSIIntDisable)
		*(.text.HibernateRTCSSMatchGet)
		*(.text.I2CMasterIntClearEx)
		*(.text.EPIPSRAMConfigRegRead)
		*(.text.GPIODirModeSet)
		*(.text.ADCComparatorIntClear)
		*(.text.EPIIntStatus)
		*(.text.QEIIntRegister)
		*(.text.WatchdogRunning)
		*(.text.SysCtlPeripheralReady)
		*(.text.SysCtlIntUnregister)
		*(.text.TimerPrescaleMatchGet)
		*(.text.UARTFlowControlSet)
		*(.text.AESDataProcess)
		*(.text.ADCComparatorIntStatus)
		*(.text.GPIOPinTypeQEI)
		*(.text.g_pui32FMPRERegs)
		*(.text.I2CSlaveFIFODisable)
		*(.text._PWMGenIntNumberGet)
		*(.text.OneWireDMADisable)
		*(.text.g_ppui32TimerIntMap)
		*(.text.I2CMasterIntDisableEx)
		*(.text.EMACHashFilterBitCalculate)
		*(.text.TimerRTCEnable)
		*(.text.UARTSmartCardEnable)
		*(.text.OneWireInit)
		*(.text.I2CSlaveIntClearEx)
		*(.text.IntPriorityMaskGet)
		*(.text.USBDevLPMDisable)
		*(.text.HibernateIntStatus)
		*(.text.LCDIDDDMADisable)
		*(.text.USBHostEndpointConfig)
		*(.text.EMACTxDMAPollDemand)
		*(.text.LCDIntUnregister)
		*(.text.I2CSlaveDisable)
		*(.text.SysCtlPeripheralDeepSleepDisable)
		*(.text.ADCReferenceGet)
		*(.text.EMACIntEnable)
		*(.text._CANDataRegWrite)
		*(.text.CANIntRegister)
		*(.text.GPIOPinTypeUART)
		*(.text.ADCProcessorTrigger)
		*(.text.CANEnable)
		*(.text.OneWireIntEnable)
		*(.text.SSILoopbackDisable)
		*(.text.SysCtlAltClkConfig)
		*(.text.USBHostEndpointStatusClear)
		*(.text.QEIVelocityDisable)
		*(.text.g_i8I2CIntMapSnowflakeRows)
		*(.text.UARTConfigSetExpClk)
		*(.text.uDMAChannelControlSet)
		*(.text.EPIPSRAMConfigRegGet)
		*(.text.EPIPSRAMConfigRegSet)
		*(.text.GPIOPinWakeStatus)
		*(.text.g_ppui32SSIIntMapSnowflake)
		*(.text.TimerConfigure)
		*(.text.USBFIFOAddrGet)
		*(.text.IntMasterDisable)
		*(.text.SSIClockSourceGet)
		*(.text.UARTDisableSIR)
		*(.text.IntPrioritySet)
		*(.text.AESDataReadNonBlocking)
		*(.text.Crc16Array3)
		*(.text.SysExcIntStatus)
		*(.text.ComparatorIntClear)
		*(.text.DESLengthSet)
		*(.text.EMACAddrFilterSet)
		*(.text.USBDevLPMEnable)
		*(.text.UARTIntDisable)
		*(.text.GPIOPinTypeGPIOOutput)
		*(.text.I2CMasterIntEnable)
		*(.text.EPIConfigHB8TimingSet)
		*(.text.EPIConfigSDRAMSet)
		*(.text.SysCtlClockGet)
		*(.text.OneWireBusReset)
		*(.text.SHAMD5IntDisable)
		*(.text._ldata)
		*(.text.EEPROMIntDisable)
		*(.text.SSIDMAEnable)
		*(.text.g_pui32PendRegs)
		*(.text.EPIIntErrorClear)
		*(.text.WatchdogValueGet)
		*(.text.SSIIntClear)
		*(.text.DESDataWrite)
		*(.text.SSIIntUnregister)
		*(.text.ADCSequenceConfigure)
		*(.text.g_pui32GPIOBaseAddrs)
		*(.text.AESKey2Set)
		*(.text.ADCClockConfigGet)
		*(.text.HibernateCounterMode)
		*(.text.GPIOPadConfigSet)
		*(.text._CANIntNumberGet)
		*(.text.UARTIntStatus)
		*(.text.TimerControlLevel)
		*(.text.IntPriorityGroupingGet)
		*(.text.LCDRasterACBiasIntCountSet)
		*(.text.SysCtlDeepSleepClockConfigSet)
		*(.text.EMACRxDMACurrentDescriptorGet)
		*(.text.QEIPositionSet)
		*(.text._EEPROMSectorMaskClear)
		*(.text.TimerLoadGet64)
		*(.text.CRCDataWrite)
		*(.text.SysCtlClockSet)
		*(.text.SHAMD5IntUnregister)
		*(.text.CANDisable)
		*(.text.ComparatorIntUnregister)
		*(.text.EMACTimestampSysTimeSet)
		*(.text.FlashProtectSave)
		*(.text.MPURegionEnable)
		*(.text.PWMDeadBandDisable)
		*(.text.HibernateLowBatGet)
		*(.text.USBFIFOFlush)
		*(.text.SHAMD5ConfigSet)
		*(.text.SysTickPeriodGet)
		*(.text.WatchdogResetDisable)
		*(.text.FPULazyStackingEnable)
		*(.text.QEIEnable)
		*(.text.EMACTxDMADescriptorListGet)
		*(.text.uDMAErrorStatusGet)
		*(.text.EPINonBlockingReadAvail)
		*(.text.SHAMD5DMAEnable)
		*(.text.EPIIntRegister)
		*(.text.SysCtlSleepPowerSet)
		*(.text.CANMessageSet)
		*(.text.AESIntStatus)
		*(.text.ADCSequenceOverflowClear)
		*(.text.LCDIDDCommandWrite)
		*(.text.UARTFlowControlGet)
		*(.text._data)
		*(.text.led_on)
		*(.text.GPIOIntClear)
		*(.text.__approm_size__)
		*(.text.HibernateClockConfig)
		*(.text.FPUFlushToZeroModeSet)
		*(.text.WatchdogStallDisable)
		*(.text._USBIndexRead)
		*(.text.SHAMD5HashLengthSet)
		*(.text.HibernateRTCSSGet)
		*(.text.USBDMAChannelIntEnable)
		*(.text.SysCtlFlashSectorSizeGet)
		*(.text.USBDevMode)
		*(.text.USBOTGMode)
		*(.text.uDMAChannelAttributeEnable)
		*(.text.WatchdogIntRegister)
		*(.text.UARTLoopbackEnable)
		*(.text.EMACVLANTxConfigSet)
		*(.text.I2CSlaveIntStatusEx)
		*(.text.PWMIntStatus)
		*(.text.SysCtlDeepSleepClockSet)
		*(.text.UARTIntEnable)
		*(.text.HibernateIntDisable)
		*(.text.WatchdogReloadSet)
		*(.text.EPIAddressMapSet)
		*(.text.FlashIntClear)
		*(.text.g_ui8SSIIntMapRows)
		*(.text.USBHostEndpointDataAck)
		*(.text.I2CSlaveDataGet)
		*(.text.EMACNumAddrGet)
		*(.text.SSIDataGet)
		*(.text.CRCResultRead)
		*(.text.TimerClockSourceGet)
		*(.text.I2CSlaveDataPut)
		*(.text.EMACVLANTxConfigGet)
		*(.text.HibernateIntRegister)
		*(.text.ComparatorConfigure)
		*(.text.SysCtlPeripheralReset)
		*(.text.PWMIntEnable)
		*(.text.WatchdogStallEnable)
		*(.text.USBHostAddrGet)
		*(.text.uDMAControlAlternateBaseGet)
		*(.text.PWMClockSet)
		*(.text.SysCtlIntRegister)
		*(.text.EPIModeSet)
		*(.text.HibernateRTCMatchGet)
		*(.text.I2CSlaveIntDisable)
		*(.text.EMACFrameFilterSet)
		*(.text.I2CSlaveIntEnableEx)
		*(.text.OneWireDMAEnable)
		*(.text.SysCtlPeripheralPresent)
		*(.text.TimerControlTrigger)
		*(.text.SysCtlDeepSleepPowerSet)
		*(.text.Crc8CCITT)
		*(.text.Crc16Array)
		*(.text.EMACTxDisable)
		*(.text.HibernateGPIORetentionDisable)
		*(.text.ComparatorIntEnable)
		*(.text.__shared_size__)
		*(.text.SysCtlPWMClockSet)
		*(.text.DESDataRead)
		*(.text.OneWireDataGet)
		*(.text.SysCtlUSBPLLEnable)
		*(.text.SHAMD5ResultRead)
		*(.text.SysExcIntEnable)
		*(.text.UARTRxErrorClear)
		*(.text.EMACTimestampTargetIntEnable)
		*(.text.USBEndpointDataAvail)
		*(.text.FPUStackingEnable)
		*(.text.LCDRasterSubPanelConfigSet)
		*(.text.ADCComparatorRegionSet)
		*(.text.IntEnable)
		*(.text.PWMFaultIntClearExt)
		*(.text.SSIDisable)
		*(.text.CANBitTimingGet)
		*(.text.g_pi16MIIClockDiv)
		*(.text.ComparatorIntStatus)
		*(.text.AESConfigSet)
		*(.text.uDMADisable)
		*(.text.USBEndpointPacketCountSet)
		*(.text.HibernateTamperExtOscRecover)
		*(.text.SysExcIntDisable)
		*(.text.USBLPMLinkStateGet)
		*(.text.EMACTxDMACurrentDescriptorGet)
		*(.text.g_ppui32TimerIntMapSnowflake)
		*(.text.GPIODMATriggerDisable)
		*(.text.TimerLoadSet64)
		*(.text.USBIntEnableEndpoint)
		*(.text.g_ui8UARTIntMapRowsSnowflake)
		*(.text.USBClockEnable)
		*(.text.FlashUserGet)
		*(.text.PWMGenFaultTriggerGet)
		*(.text.FPUHalfPrecisionModeSet)
		*(.text.CANIntClear)
		*(.text.ADCHardwareOversampleConfigure)
		*(.text.EPIWorkaroundWordWrite)
		*(.text.PWMFaultIntClear)
		*(.text.SSIBusy)
		*(.text.EMACVLANHashFilterBitCalculate)
		*(.text.g_ui8SSIIntMapSnowflakeRows)
		*(.text.LCDRasterDisable)
		*(.text.ADCSequenceDataGet)
		*(.text.UARTDMAEnable)
		*(.text.AESIntRegister)
		*(.text.IntPendSet)
		*(.text.I2CSlaveACKOverride)
		*(.text.EEPROMMassErase)
		*(.text.EPIIntEnable)
		*(.text.EEPROMBlockLock)
		*(.text.PWMGenIntTrigEnable)
		*(.text.MPUIntRegister)
		*(.text.USBDevAddrSet)
		*(.text.TimerPrescaleGet)
		*(.text.OneWireDataGetNonBlocking)
		*(.text.OneWireIntRegister)
		*(.text.LCDIntDisable)
		*(.text.SysTickIntEnable)
		*(.text.GPIOPadConfigGet)
		*(.text.CANErrCntrGet)
		*(.text.EMACRemoteWakeUpFrameFilterSet)
		*(.text.EMACFrameFilterGet)
		*(.text.GPIOIntDisable)
		*(.text.g_ppui32GPIOIntMapBlizzard)
		*(.text.uDMAChannelAssign)
		*(.text.EMACInit)
		*(.text.ADCSequenceEnable)
		*(.text.ADCPhaseDelayGet)
		*(.text.SHAMD5IntClear)
		*(.text.UARTDMADisable)
		*(.text.SysTickIntRegister)
		*(.text.SSIDataPut)
		*(.text.EMACHashFilterGet)
		*(.text.CPUbasepriSet)
		*(.text.USBFIFOConfigSet)
		*(.text.HibernateEnableExpClk)
		*(.text.ComparatorIntRegister)
		*(.text.EPIConfigHB16Set)
		*(.text.QEIFilterDisable)
		*(.text.I2CMasterBurstCountGet)
		*(.text.EMACPowerManagementStatusGet)
		*(.text.HibernateLowBatSet)
		*(.text.EMACLPILinkClear)
		*(.text.USBHighSpeed)
		*(.text.EMACDMAStateGet)
		*(.text.GPIODirModeGet)
		*(.text.AESIVSet)
		*(.text.SysCtlVoltageEventClear)
		*(.text.HibernateRTCSet)
		*(.text.SysCtlLDOSleepGet)
		*(.text.I2CIntRegister)
		*(.text.EPINonBlockingReadGet8)
		*(.text.AESDataWrite)
		*(.text.FlashProgram)
		*(.text.SysTickPeriodSet)
		*(.text.I2CMasterGlitchFilterConfigSet)
		*(.text.I2CMasterDataPut)
		*(.text._EEPROMWaitForDone)
		*(.text.TimerIntStatus)
		*(.text.LCDIntEnable)
		*(.text.TimerIntRegister)
		*(.text.DESReset)
		*(.text.WatchdogEnable)
		*(.text.g_pui32Dii16Regs)
		*(.text.FPURoundingModeSet)
		*(.text.ADCClockConfigSet)
		*(.text.FlashProtectGet)
		*(.text.LCDRasterSubPanelEnable)
		*(.text.EMACRxDMADescriptorListGet)
		*(.text.USBDevAddrGet)
		*(.text.ADCIntRegister)
		*(.text.CRCConfigSet)
		*(.text.I2CFIFODataGetNonBlocking)
		*(.text.I2CMasterIntEnableEx)
		*(.text.SysCtlPeripheralSleepEnable)
		*(.text.USBDevEndpointStatusClear)
		*(.text.g_pui32Priority)
		*(.text.AESLengthSet)
		*(.text.EPIWriteFIFOCountGet)
		*(.text.I2CSlaveACKValueSet)
		*(.text.LCDIDDIndexedWrite)
		*(.text.OneWireIntClear)
		*(.text.uDMAChannelRequest)
		*(.text.SysCtlDelay)
		*(.text.GPIOPinTypeSSI)
		*(.text.ADCComparatorConfigure)
		*(.text.uDMAChannelScatterGatherSet)
		*(.text.SysCtlPeripheralPowerOn)
		*(.text.uDMAChannelAttributeGet)
		*(.text.EMACTimestampPPSPeriodSet)
		*(.text.FPUNaNModeSet)
		*(.text.USBHostEndpointDataToggle)
		*(.text.SHAMD5IntStatus)
		*(.text.SysCtlVoltageEventStatus)
		*(.text.DESIntRegister)
		*(.text.EMACTimestampTargetIntDisable)
		*(.text.SysTickValueGet)
		*(.text.PWMSyncTimeBase)
		*(.text.MPUIntUnregister)
		*(.text.USBHostRequestINClear)
		*(.text.USBDMAChannelDisable)
		*(.text.USBHostSpeedGet)
		*(.text.I2CMasterDataGet)
		*(.text.g_pui32Regs)
		*(.text.GPIOPinTypeTrace)
		*(.text.I2CMasterLineStateGet)
		*(.text.SSIAdvModeSet)
		*(.text.USBEndpointDMAChannel)
		*(.text.g_pui32Xtals)
		*(.text.USBEndpointDMADisable)
		*(.text.PWMFaultIntUnregister)
		*(.text.TimerControlStall)
		*(.text.g_pui32VCOFrequencies)
		*(.text.LCDRasterEnable)
		*(.text.HibernateCalendarMatchGet)
		*(.text.PWMOutputState)
		*(.text.PWMOutputFaultLevel)
		*(.text.OneWireBusStatus)
		*(.text.USBHostRequestStatus)
		*(.text.DESDataProcess)
		*(.text.DESIntUnregister)
		*(.text.EPIWorkaroundByteWrite)
		*(.text.FlashIntEnable)
		*(.text.HibernateWakeSet)
		*(.text.EMACTimestampPPSCommand)
		*(.text.I2CMasterSlaveAddrSet)
		*(.text.SHAMD5DataWrite)
		*(.text.HibernateCalendarMatchSet)
		*(.text.USBDevEndpointDataAck)
		*(.text.EMACReset)
		*(.text.GPIOPinTypeLCD)
		*(.text.USBDMAChannelConfigSet)
		*(.text.EMACLPIConfig)
		*(.text.GPIOPinTypeComparatorOutput)
		*(.text.GPIOIntEnable)
		*(.text.EMACHashFilterSet)
		*(.text.USBDevLPMRemoteWake)
		*(.text.AESDMADisable)
		*(.text.EPIWorkaroundByteRead)
		*(.text.g_sXTALtoMEMTIM)
		*(.text.SSIAdvFrameHoldEnable)
		*(.text.HibernateTamperEventsClearNoLock)
		*(.text.ADCIntDisable)
		*(.text.MPURegionDisable)
		*(.text.uDMAChannelSelectSecondary)
		*(.text.EPINonBlockingReadStop)
		*(.text.uDMAEnable)
		*(.text.EMACVLANHashFilterGet)
		*(.text.PWMIntDisable)
		*(.text.USBDMANumChannels)
		*(.text.USBDevEndpointConfigSet)
		*(.text.HibernateTamperEventsGet)
		*(.text.USBDevEndpointStall)
		*(.text._ADCIntNumberGet)
		*(.text.UARTModemControlSet)
		*(.text.EPINonBlockingReadCount)
		*(.text._IntDefaultHandler)
		*(.text.EPIConfigHB16CSSet)
	}

    .data : AT(ADDR(.text) + SIZEOF(.text))
    {
        _data = .;
        _ldata = LOADADDR (.data);
        *(vtable)
        *(.data*)
        _edata = .;
    } > SRAM

    .bss :
    {
        _bss = .;
        *(.bss*)
        *(COMMON)
        _ebss = .;
    } > SRAM
}

INCLUDE build/sharedMemory/shared_syms.ld
